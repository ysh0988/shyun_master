AUTOSAR XML (schema 00047)
package /AUTRON
  module config ComM: implementation-config-variant=VARIANT-PRE-COMPILE, module-description=BswImplementation_ComM, post-build-variant-used=false
    ComMGeneral:
      ComMEcuGroupClassification = 3
      ComMPncSupport = 1
      ComMResetAfterForcingNoComm = 1
      ComMSynchronousWakeUp = 1
      ComMTMinFullComModeDuration = 5
      ComMVersionInfoApi = 1
      ComMWakeupInhibitionEnabled = 1
      ComM0PncVectorAvoidance = 0
      ComMPncGatewayEnabled = 0
      ComMDirectUserMapping = 1
      ComMPncPrepareSleepTimer = 0.5
      ComMDevErrorDetect = 1
      ComMCanCMSupport = 1
      ComMModeLimitationEnabled = 1
      ComMBusloadDetectingApi = 0
    ComMConfigSet: ComMPncEnabled=1
      ComMUser_PNC32 (ComMUser): category=TOOL_CONFIGURED, ComMUserIdentifier=2
      ComMPnc_PNC32 (ComMPnc): category=TOOL_CONFIGURED, ComMPncId=32, ComMUserPerPnc=ComMUser_PNC32, ComMChannelPerPnc=ComMChannel_CCAN
        ComMPnc_ComSignal_Rx_Can_PNC_32 (ComMPncComSignal):
          category = TOOL_CONFIGURED
          ComMPncComSignalKind = EIRA
          ComMPncComSignalDirection = RX
          ComMPncComSignalChannelRef = ComMChannel_CCAN
          ComMPncComSignalRef = ComISignal_Rx_EIRA_CanNm
        ComMPnc_ComSignal_Tx_CCAN_PNC_32 (ComMPncComSignal):
          category = TOOL_CONFIGURED
          ComMPncComSignalKind = EIRA
          ComMPncComSignalDirection = TX
          ComMPncComSignalChannelRef = ComMChannel_CCAN
          ComMPncComSignalRef = ComISignal_Tx_PncVector_CCAN
      ComMChannel_CCAN (ComMChannel):
        category = TOOL_CONFIGURED
        ComMNoWakeUpInhibitionNvmStorage = 0
        ComMBusType = COMM_BUS_TYPE_CAN
        ComMChannelId = 0
        ComMMainFunctionPeriod = 0.005
        ComMNoCom = 1
        ComMFullCommRequestNotificationEnabled = 0
        ComMNoWakeup = 0
        ComMNetworkManagement_CCAN (ComMNetworkManagement): category=TOOL_CONFIGURED, ComMNmLightTimeout=0, ComMNmVariant=FULL, ComMPncNmRequest=0
      ComMUser_PNC171 (ComMUser): category=TOOL_CONFIGURED, ComMUserIdentifier=0
      ComMUser_PNC152 (ComMUser): category=TOOL_CONFIGURED, ComMUserIdentifier=1
      ComMPnc_PNC171 (ComMPnc): category=TOOL_CONFIGURED, ComMPncId=171, ComMChannelPerPnc=ComMChannel_CCAN, ComMUserPerPnc=ComMUser_PNC171
        ComMPnc_ComSignal_Tx_CCAN_PNC_171 (ComMPncComSignal):
          category = TOOL_CONFIGURED
          ComMPncComSignalKind = EIRA
          ComMPncComSignalDirection = TX
          ComMPncComSignalChannelRef = ComMChannel_CCAN
          ComMPncComSignalRef = ComISignal_Tx_PncVector_CCAN
        ComMPnc_ComSignal_Rx_Can_PNC_171 (ComMPncComSignal): category=TOOL_CONFIGURED, ComMPncComSignalKind=EIRA, ComMPncComSignalDirection=RX, ComMPncComSignalRef=ComISignal_Rx_EIRA_CanNm
      ComMPnc_PNC152 (ComMPnc): category=TOOL_CONFIGURED, ComMPncId=152, ComMChannelPerPnc=ComMChannel_CCAN, ComMUserPerPnc=ComMUser_PNC152
        ComMPnc_ComSignal_Tx_CCAN_PNC_152 (ComMPncComSignal):
          category = TOOL_CONFIGURED
          ComMPncComSignalKind = EIRA
          ComMPncComSignalDirection = TX
          ComMPncComSignalChannelRef = ComMChannel_CCAN
          ComMPncComSignalRef = ComISignal_Tx_PncVector_CCAN
        ComMPnc_ComSignal_Rx_Can_PNC_152 (ComMPncComSignal): category=TOOL_CONFIGURED, ComMPncComSignalKind=EIRA, ComMPncComSignalDirection=RX, ComMPncComSignalRef=ComISignal_Rx_EIRA_CanNm
