AUTOSAR XML (schema 00047)
package /AUTRON
  module config Com: implementation-config-variant=VARIANT-PRE-COMPILE, module-description=BswImplementation_Com
    ComConfig
      ComTimeBase: category=TOOL_CONFIGURED, ComGwTimeBase=0.005, ComRxTimeBase=0.005, ComTxTimeBase=0.005
      ComIPduGroupRx_SBW_FD_P2 (ComIPduGroup): category=TOOL_CONFIGURED, ComIPduGroupHandleId=0
      ComIPduGroupTx_SBW_FD_P2 (ComIPduGroup): category=TOOL_CONFIGURED, ComIPduGroupHandleId=1
      39 x ComIPdu, all with category=TOOL_CONFIGURED, ComIPduType=NORMAL, ComIPduSignalProcessing=DEFERRED:
        ComIPdu_FD_P1_WAKEUP_01_00ms: ComIPduDirection=RECEIVE, ComIPduHandleId=0, ComIPduSignalGroupRef=ComISignalGroup_MsgGr_FD_P1_WAKEUP_01_00ms, ComPduIdRef=Pdu_ISignalIPdu_FD_P1_WAKEUP_01_00ms, ComIPduGroupRef=ComIPduGroupRx_SBW_FD_P1_PNC32_PNC73_DiagComControl
        ComIPdu_FD_P1_HTCU_04_10ms: ComIPduDirection=RECEIVE, ComIPduHandleId=1, ComIPduSignalGroupRef=ComISignalGroup_MsgGr_E2E_FD_P1_HTCU_04_10ms, ComPduIdRef=Pdu_ISignalIPdu_FD_P1_HTCU_04_10ms, ComIPduGroupRef=ComIPduGroupRx_SBW_FD_P1_PNC32_PNC73_DiagComControl
        ComIPdu_FD_P1_SBW_CCP_REQ: ComIPduDirection=RECEIVE, ComIPduHandleId=2, ComIPduSignalGroupRef=ComISignalGroup_MsgGr_FD_P1_SBW_CCP_REQ, ComPduIdRef=Pdu_ISignalIPdu_FD_P1_SBW_CCP_REQ, ComIPduGroupRef=ComIPduGroupRx_SBW_FD_P1_PNC32_PNC73_DiagComControl
        ComIPdu_FD_P1_PDC_FD_15_300ms: ComIPduDirection=RECEIVE, ComIPduHandleId=3, ComIPduSignalGroupRef=ComISignalGroup_MsgGr_E2E_FD_P1_PDC_FD_15_300ms, ComPduIdRef=Pdu_ISignalIPdu_FD_P1_PDC_FD_15_300ms, ComIPduGroupRef=ComIPduGroupRx_SBW_FD_P1_PNC32_PNC73_DiagComControl
        ComIPdu_FD_P1_HTCU_07_100ms: ComIPduDirection=RECEIVE, ComIPduHandleId=4, ComIPduSignalGroupRef=ComISignalGroup_MsgGr_E2E_FD_P1_HTCU_07_100ms, ComPduIdRef=Pdu_ISignalIPdu_FD_P1_HTCU_07_100ms, ComIPduGroupRef=ComIPduGroupRx_SBW_FD_P1_PNC32_PNC73_DiagComControl
        ComIPdu_FD_P1_SBW_CCP_RESP: ComIPduDirection=SEND, ComIPduHandleId=0, ComIPduSignalGroupRef=ComISignalGroup_MsgGr_FD_P1_SBW_CCP_RESP, ComPduIdRef=Pdu_ISignalIPdu_FD_P1_SBW_CCP_RESP, ComIPduGroupRef=ComIPduGroupTx_SBW_FD_P1_PNC32_PNC73_DiagComControl
          ComTxIpdu_ComIPdu_FD_P1_SBW_CCP_RESP (ComTxIPdu): category=TOOL_CONFIGURED, ComTxIPduUnusedAreasDefault=0, ComMinimumDelayTime=0.01
            ComTxModeTrue_ComTxIpdu_ComIPdu_FD_P1_SBW_CCP_RESP (ComTxModeTrue): category=TOOL_CONFIGURED
              ComTxMode_ComTxModeTrue_ComTxIpdu_ComIPdu_FD_P1_SBW_CCP_RESP (ComTxMode): category=TOOL_CONFIGURED, ComTxModeNumberOfRepetitions=0, ComTxModeRepetitionPeriod=0.04, ComTxModeMode=DIRECT
        ComIPdu_FD_P1_CLU_02_100ms: ComIPduDirection=RECEIVE, ComIPduHandleId=5, ComIPduSignalGroupRef=ComISignalGroup_MsgGr_FD_P1_CLU_02_100ms, ComPduIdRef=Pdu_ISignalIPdu_FD_P1_CLU_02_100ms, ComIPduGroupRef=ComIPduGroupRx_SBW_FD_P1_PNC32_PNC73_DiagComControl
        ComIPdu_FD_P1_TCU_01_10ms: ComIPduDirection=RECEIVE, ComIPduHandleId=6, ComIPduSignalGroupRef=ComISignalGroup_MsgGr_E2E_FD_P1_TCU_01_10ms, ComPduIdRef=Pdu_ISignalIPdu_FD_P1_TCU_01_10ms, ComIPduGroupRef=ComIPduGroupRx_SBW_FD_P1_PNC32_PNC73_DiagComControl
        ComIPdu_FD_P1_HU_USM_06_00ms: ComIPduDirection=RECEIVE, ComIPduHandleId=7, ComIPduSignalGroupRef=ComISignalGroup_MsgGr_FD_P1_HU_USM_06_00ms, ComPduIdRef=Pdu_ISignalIPdu_FD_P1_HU_USM_06_00ms, ComIPduGroupRef=ComIPduGroupRx_SBW_FD_P1_PNC32_PNC73_DiagComControl
        ComIPdu_FD_P1_VCU_04_100ms: ComIPduDirection=RECEIVE, ComIPduHandleId=8, ComIPduSignalGroupRef=ComISignalGroup_MsgGr_FD_P1_VCU_04_100ms, ComPduIdRef=Pdu_ISignalIPdu_FD_P1_VCU_04_100ms, ComIPduGroupRef=ComIPduGroupRx_SBW_FD_P1_PNC32_PNC73_DiagComControl
        ComIPdu_FD_P1_SBCM_RR_FD_01_200ms: ComIPduDirection=RECEIVE, ComIPduHandleId=9, ComIPduSignalGroupRef=ComISignalGroup_MsgGr_FD_P1_SBCM_RR_FD_01_200ms, ComPduIdRef=Pdu_ISignalIPdu_FD_P1_SBCM_RR_FD_01_200ms, ComIPduGroupRef=ComIPduGroupRx_SBW_FD_P1_PNC32_PNC73_DiagComControl
        ComIPdu_FD_P1_BDC_FD_SMK_02_200ms: ComIPduDirection=RECEIVE, ComIPduHandleId=10, ComIPduSignalGroupRef=ComISignalGroup_MsgGr_FD_P1_BDC_FD_SMK_02_200ms, ComPduIdRef=Pdu_ISignalIPdu_FD_P1_BDC_FD_SMK_02_200ms, ComIPduGroupRef=ComIPduGroupRx_SBW_FD_P1_PNC32_PNC73_DiagComControl
        ComIPdu_FD_P1_BDC_FD_SMK_03_200ms: ComIPduDirection=RECEIVE, ComIPduHandleId=11, ComIPduSignalGroupRef=ComISignalGroup_MsgGr_FD_P1_BDC_FD_SMK_03_200ms, ComPduIdRef=Pdu_ISignalIPdu_FD_P1_BDC_FD_SMK_03_200ms, ComIPduGroupRef=ComIPduGroupRx_SBW_FD_P1_PNC32_PNC73_DiagComControl
        ComIPdu_FD_P1_SBCM_RL_FD_01_200ms: ComIPduDirection=RECEIVE, ComIPduHandleId=12, ComIPduSignalGroupRef=ComISignalGroup_MsgGr_FD_P1_SBCM_RL_FD_01_200ms, ComPduIdRef=Pdu_ISignalIPdu_FD_P1_SBCM_RL_FD_01_200ms, ComIPduGroupRef=ComIPduGroupRx_SBW_FD_P1_PNC32_PNC73_DiagComControl
        ComIPdu_FD_P1_SCU_FF_01_10ms: ComIPduDirection=RECEIVE, ComIPduHandleId=13, ComIPduSignalGroupRef=ComISignalGroup_MsgGr_E2E_FD_P1_SCU_FF_01_10ms, ComPduIdRef=Pdu_ISignalIPdu_FD_P1_SCU_FF_01_10ms, ComIPduGroupRef=ComIPduGroupRx_SBW_FD_P1_PNC32_PNC73_DiagComControl
        ComIPdu_FD_P1_EMS_02_10ms: ComIPduDirection=RECEIVE, ComIPduHandleId=14, ComIPduSignalGroupRef=ComISignalGroup_MsgGr_FD_P1_EMS_02_10ms, ComPduIdRef=Pdu_ISignalIPdu_FD_P1_EMS_02_10ms, ComIPduGroupRef=ComIPduGroupRx_SBW_FD_P1_PNC32_PNC73_DiagComControl
        ComIPdu_FD_P1_PDC_FD_02_200ms: ComIPduDirection=RECEIVE, ComIPduHandleId=15, ComIPduSignalGroupRef=ComISignalGroup_MsgGr_FD_P1_PDC_FD_02_200ms, ComPduIdRef=Pdu_ISignalIPdu_FD_P1_PDC_FD_02_200ms, ComIPduGroupRef=ComIPduGroupRx_SBW_FD_P1_PNC32_PNC73_DiagComControl
        ComIPdu_FD_P1_SBCM_DRV_FD_01_200ms: ComIPduDirection=RECEIVE, ComIPduHandleId=16, ComIPduSignalGroupRef=ComISignalGroup_MsgGr_FD_P1_SBCM_DRV_FD_01_200ms, ComPduIdRef=Pdu_ISignalIPdu_FD_P1_SBCM_DRV_FD_01_200ms, ComIPduGroupRef=ComIPduGroupRx_SBW_FD_P1_PNC32_PNC73_DiagComControl
        ComIPdu_FD_P1_PDC_FD_01_200ms: ComIPduDirection=RECEIVE, ComIPduHandleId=17, ComIPduSignalGroupRef=ComISignalGroup_MsgGr_FD_P1_PDC_FD_01_200ms, ComPduIdRef=Pdu_ISignalIPdu_FD_P1_PDC_FD_01_200ms, ComIPduGroupRef=ComIPduGroupRx_SBW_FD_P1_PNC32_PNC73_DiagComControl
        ComIPdu_FD_P1_PDC_FD_03_200ms: ComIPduDirection=RECEIVE, ComIPduHandleId=18, ComIPduSignalGroupRef=ComISignalGroup_MsgGr_E2E_FD_P1_PDC_FD_03_200ms, ComPduIdRef=Pdu_ISignalIPdu_FD_P1_PDC_FD_03_200ms, ComIPduGroupRef=ComIPduGroupRx_SBW_FD_P1_PNC32_PNC73_DiagComControl
        ComIPdu_FD_P1_SBW_SHFTR_FF_01_10ms: ComIPduDirection=SEND, ComIPduHandleId=2, ComIPduSignalGroupRef=ComISignalGroup_MsgGr_E2E_FD_P1_SBW_SHFTR_FF_01_10ms, ComPduIdRef=Pdu_ISignalIPdu_FD_P1_SBW_SHFTR_FF_01_10ms, ComIPduGroupRef=ComIPduGroupTx_SBW_FD_P1_PNC32_PNC73_NoDiagComControl
          ComTxIpdu_ComIPdu_FD_P1_SBW_SHFTR_FF_01_10ms (ComTxIPdu): category=TOOL_CONFIGURED, ComTxIPduUnusedAreasDefault=0, ComMinimumDelayTime=0.0
            ComTxModeTrue_ComTxIpdu_ComIPdu_FD_P1_SBW_SHFTR_FF_01_10ms (ComTxModeTrue): category=TOOL_CONFIGURED
              ComTxMode_ComTxModeTrue_ComTxIpdu_ComIPdu_FD_P1_SBW_SHFTR_FF_01_10ms (ComTxMode): category=TOOL_CONFIGURED, ComTxModeTimeOffset=0.0, ComTxModeTimePeriod=0.01, ComTxModeMode=PERIODIC
        ComIPdu_FD_P1_IEB_01_10ms: ComIPduDirection=RECEIVE, ComIPduHandleId=19, ComIPduSignalGroupRef=ComISignalGroup_MsgGr_FD_P1_IEB_01_10ms, ComPduIdRef=Pdu_ISignalIPdu_FD_P1_IEB_01_10ms, ComIPduGroupRef=ComIPduGroupRx_SBW_FD_P1_PNC32_PNC73_DiagComControl
        ComIPdu_FD_P1_ICC_02_50ms: ComIPduDirection=RECEIVE, ComIPduHandleId=20, ComIPduSignalGroupRef=ComISignalGroup_MsgGr_FD_P1_ICC_02_50ms, ComPduIdRef=Pdu_ISignalIPdu_FD_P1_ICC_02_50ms, ComIPduGroupRef=ComIPduGroupRx_SBW_FD_P1_PNC32_PNC73_DiagComControl
        ComIPdu_FD_P1_BDC_FD_03_200ms: ComIPduDirection=RECEIVE, ComIPduHandleId=21, ComIPduSignalGroupRef=ComISignalGroup_MsgGr_FD_P1_BDC_FD_03_200ms, ComPduIdRef=Pdu_ISignalIPdu_FD_P1_BDC_FD_03_200ms, ComIPduGroupRef=ComIPduGroupRx_SBW_FD_P1_PNC32_PNC73_DiagComControl
        ComIPdu_FD_P1_BDC_FD_04_200ms: ComIPduDirection=RECEIVE, ComIPduHandleId=22, ComIPduSignalGroupRef=ComISignalGroup_MsgGr_FD_P1_BDC_FD_04_200ms, ComPduIdRef=Pdu_ISignalIPdu_FD_P1_BDC_FD_04_200ms, ComIPduGroupRef=ComIPduGroupRx_SBW_FD_P1_PNC32_PNC73_DiagComControl
        ComIPdu_FD_P1_CCU_MCU_01_200ms: ComIPduDirection=RECEIVE, ComIPduHandleId=23, ComIPduSignalGroupRef=ComISignalGroup_MsgGr_E2E_FD_P1_CCU_MCU_01_200ms, ComPduIdRef=Pdu_ISignalIPdu_FD_P1_CCU_MCU_01_200ms, ComIPduGroupRef=ComIPduGroupRx_SBW_FD_P1_PNC32_PNC73_NoDiagComControl
        ComIPdu_FD_P1_WHL_01_10ms: ComIPduDirection=RECEIVE, ComIPduHandleId=24, ComIPduSignalGroupRef=ComISignalGroup_MsgGr_FD_P1_WHL_01_10ms, ComPduIdRef=Pdu_ISignalIPdu_FD_P1_WHL_01_10ms, ComIPduGroupRef=ComIPduGroupRx_SBW_FD_P1_PNC32_PNC73_DiagComControl
        ComIPdu_FD_P1_BDC_FD_02_200ms: ComIPduDirection=RECEIVE, ComIPduHandleId=25, ComIPduSignalGroupRef=ComISignalGroup_MsgGr_FD_P1_BDC_FD_02_200ms, ComPduIdRef=Pdu_ISignalIPdu_FD_P1_BDC_FD_02_200ms, ComIPduGroupRef=ComIPduGroupRx_SBW_FD_P1_PNC32_PNC73_DiagComControl
        ComIPdu_FD_P1_TCU_02_10ms: ComIPduDirection=RECEIVE, ComIPduHandleId=26, ComIPduSignalGroupRef=ComISignalGroup_MsgGr_E2E_FD_P1_TCU_02_10ms, ComPduIdRef=Pdu_ISignalIPdu_FD_P1_TCU_02_10ms, ComIPduGroupRef=ComIPduGroupRx_SBW_FD_P1_PNC32_PNC73_DiagComControl
        ComIPdu_FD_P1_BDC_FD_05_200ms: ComIPduDirection=RECEIVE, ComIPduHandleId=27, ComIPduSignalGroupRef=ComISignalGroup_MsgGr_FD_P1_BDC_FD_05_200ms, ComPduIdRef=Pdu_ISignalIPdu_FD_P1_BDC_FD_05_200ms, ComIPduGroupRef=ComIPduGroupRx_SBW_FD_P1_PNC32_PNC73_DiagComControl
        ComIPdu_FD_P1_BDC_FD_06_200ms: ComIPduDirection=RECEIVE, ComIPduHandleId=28, ComIPduSignalGroupRef=ComISignalGroup_MsgGr_FD_P1_BDC_FD_06_200ms, ComPduIdRef=Pdu_ISignalIPdu_FD_P1_BDC_FD_06_200ms, ComIPduGroupRef=ComIPduGroupRx_SBW_FD_P1_PNC32_PNC73_DiagComControl
        ComIPdu_FD_P1_PRAC_01_300ms: ComIPduDirection=RECEIVE, ComIPduHandleId=29, ComIPduSignalGroupRef=ComISignalGroup_MsgGr_E2E_FD_P1_PRAC_01_300ms, ComPduIdRef=Pdu_ISignalIPdu_FD_P1_PRAC_01_300ms, ComIPduGroupRef=ComIPduGroupRx_SBW_FD_P1_PNC32_PNC73_DiagComControl
        ComIPdu_FD_P1_CLU_01_20ms: ComIPduDirection=RECEIVE, ComIPduHandleId=30, ComIPduSignalGroupRef=ComISignalGroup_MsgGr_FD_P1_CLU_01_20ms, ComPduIdRef=Pdu_ISignalIPdu_FD_P1_CLU_01_20ms, ComIPduGroupRef=ComIPduGroupRx_SBW_FD_P1_PNC32_PNC73_DiagComControl
        ComIPdu_FD_P1_BDC_FD_SMK_01_00ms: ComIPduDirection=RECEIVE, ComIPduHandleId=31, ComIPduSignalGroupRef=ComISignalGroup_MsgGr_FD_P1_BDC_FD_SMK_01_00ms, ComPduIdRef=Pdu_ISignalIPdu_FD_P1_BDC_FD_SMK_01_00ms, ComIPduGroupRef=ComIPduGroupRx_SBW_FD_P1_PNC32_PNC73_DiagComControl
        ComIPdu_FD_P1_HCU_03_10ms: ComIPduDirection=RECEIVE, ComIPduHandleId=32, ComIPduSignalGroupRef=ComISignalGroup_MsgGr_E2E_FD_P1_HCU_03_10ms, ComPduIdRef=Pdu_ISignalIPdu_FD_P1_HCU_03_10ms, ComIPduGroupRef=ComIPduGroupRx_SBW_FD_P1_PNC32_PNC73_DiagComControl
        ComIPdu_FD_P1_VCU_01_10ms: ComIPduDirection=RECEIVE, ComIPduHandleId=33, ComIPduSignalGroupRef=ComISignalGroup_MsgGr_E2E_FD_P1_VCU_01_10ms, ComPduIdRef=Pdu_ISignalIPdu_FD_P1_VCU_01_10ms, ComIPduGroupRef=ComIPduGroupRx_SBW_FD_P1_PNC32_PNC73_DiagComControl
        ComIPdu_FD_P1_BDC_FD_RKE_01_00ms: ComIPduDirection=RECEIVE, ComIPduHandleId=34, ComIPduSignalGroupRef=ComISignalGroup_MsgGr_FD_P1_BDC_FD_RKE_01_00ms, ComPduIdRef=Pdu_ISignalIPdu_FD_P1_BDC_FD_RKE_01_00ms, ComIPduGroupRef=ComIPduGroupRx_SBW_FD_P1_PNC32_PNC73_DiagComControl
        ComIPdu_FD_P1_VCMS_02_100ms: ComIPduDirection=RECEIVE, ComIPduHandleId=35, ComIPduSignalGroupRef=ComISignalGroup_MsgGr_FD_P1_VCMS_02_100ms, ComPduIdRef=Pdu_ISignalIPdu_FD_P1_VCMS_02_100ms, ComIPduGroupRef=ComIPduGroupRx_SBW_FD_P1_PNC32_PNC73_DiagComControl
        ComIPdu_FD_P1_EMS_01_10ms: ComIPduDirection=RECEIVE, ComIPduHandleId=36, ComIPduSignalGroupRef=ComISignalGroup_MsgGr_FD_P1_EMS_01_10ms, ComPduIdRef=Pdu_ISignalIPdu_FD_P1_EMS_01_10ms, ComIPduGroupRef=ComIPduGroupRx_SBW_FD_P1_PNC32_PNC73_DiagComControl
      11 x ComSignalGroup, all with category=TOOL_CONFIGURED, ComSignalGroupArrayAccess=1:
        ComISignalGroup_MsgGr_E2E_FD_P1_CCU_MCU_01_200ms: ComHandleId=23, ComTimeout=1.5, ComTransferProperty=TRIGGERED_ON_CHANGE, ComSystemTemplateSignalGroupRef=MsgGr_FD_P1_CCU_MCU_01_200ms
          5 x ComGroupSignal, all with category=TOOL_CONFIGURED, ComSignalEndianness=LITTLE_ENDIAN:
            FD_P1_CCU_MCU_01_200ms_CCU_MCU_Crc1Val: ComBitPosition=0, ComTransferProperty=PENDING, ComSignalInitValue=65535, ComBitSize=16, ComSignalLength=2, ComSignalType=UINT16, ComHandleId=72, ComSystemTemplateSystemSignalRef=CCU_MCU_Crc1Val
            FD_P1_CCU_MCU_01_200ms_CCU_MCU_AlvCnt1Val: ComBitPosition=16, ComTransferProperty=PENDING, ComSignalInitValue=0, ComBitSize=8, ComSignalLength=1, ComSignalType=UINT8, ComHandleId=73, ComSystemTemplateSystemSignalRef=CCU_MCU_AlvCnt1Val
            FD_P1_CCU_MCU_01_200ms_CCU_update_enable: ComBitPosition=26, ComTransferProperty=TRIGGERED_ON_CHANGE, ComSignalInitValue=3, ComBitSize=2, ComSignalLength=1, ComSignalType=UINT8, ComHandleId=75, ComSystemTemplateSystemSignalRef=CCU_update_enable
            FD_P1_CCU_MCU_01_200ms_CCU_MCU_01_200ms_E2EReserved: ComBitPosition=63, ComSignalInitValue=0, ComBitSize=1, ComSignalLength=1, ComSignalType=BOOLEAN, ComHandleId=76, ComSystemTemplateSystemSignalRef=CCU_MCU_01_200ms_E2EReserved
            FD_P1_CCU_MCU_01_200ms_CCU_OTA_crank_inh: ComBitPosition=24, ComTransferProperty=TRIGGERED_ON_CHANGE, ComSignalInitValue=3, ComBitSize=2, ComSignalLength=1, ComSignalType=UINT8, ComHandleId=74, ComSystemTemplateSystemSignalRef=CCU_OTA_crank_inh
        ComISignalGroup_MsgGr_E2E_FD_P1_HTCU_04_10ms: ComHandleId=1, ComTimeout=0.5, ComTransferProperty=PENDING, ComSystemTemplateSignalGroupRef=MsgGr_FD_P1_HTCU_04_10ms
          7 x ComGroupSignal, all with category=TOOL_CONFIGURED, ComSignalEndianness=LITTLE_ENDIAN:
            FD_P1_HTCU_04_10ms_HTCU_Crc4Val: ComBitPosition=0, ComTransferProperty=PENDING, ComSignalInitValue=65535, ComBitSize=16, ComSignalLength=2, ComSignalType=UINT16, ComHandleId=6, ComSystemTemplateSystemSignalRef=HTCU_Crc4Val
            FD_P1_HTCU_04_10ms_HTCU_AlvCnt4Val: ComBitPosition=16, ComTransferProperty=PENDING, ComSignalInitValue=0, ComBitSize=8, ComSignalLength=1, ComSignalType=UINT8, ComHandleId=7, ComSystemTemplateSystemSignalRef=HTCU_AlvCnt4Val
            FD_P1_HTCU_04_10ms_HTCU_GearSlctrDis: ComBitPosition=44, ComTransferProperty=PENDING, ComSignalInitValue=9, ComBitSize=4, ComSignalLength=1, ComSignalType=UINT8, ComHandleId=8, ComSystemTemplateSystemSignalRef=HTCU_GearSlctrDis
            FD_P1_HTCU_04_10ms_HTCU_VehSpdKphVal: ComBitPosition=64, ComTransferProperty=PENDING, ComSignalInitValue=0, ComBitSize=8, ComSignalLength=1, ComSignalType=UINT8, ComHandleId=9, ComSystemTemplateSystemSignalRef=HTCU_VehSpdKphVal
            FD_P1_HTCU_04_10ms_HTCU_VehSpdDcmlKphVal: ComBitPosition=72, ComTransferProperty=PENDING, ComSignalInitValue=0, ComBitSize=8, ComSignalLength=1, ComSignalType=UINT8, ComHandleId=10, ComSystemTemplateSystemSignalRef=HTCU_VehSpdDcmlKphVal
            FD_P1_HTCU_04_10ms_HTCU_PrkReleaseReq: ComBitPosition=172, ComTransferProperty=PENDING, ComSignalInitValue=0, ComBitSize=2, ComSignalLength=1, ComSignalType=UINT8, ComHandleId=11, ComSystemTemplateSystemSignalRef=HTCU_PrkReleaseReq
            FD_P1_HTCU_04_10ms_HTCU_04_10ms_E2EReserved: ComBitPosition=191, ComSignalInitValue=0, ComBitSize=1, ComSignalLength=1, ComSignalType=BOOLEAN, ComHandleId=12, ComSystemTemplateSystemSignalRef=HTCU_04_10ms_E2EReserved
        ComISignalGroup_MsgGr_E2E_FD_P1_HTCU_07_100ms: ComHandleId=4, ComTimeout=1.5, ComTransferProperty=PENDING, ComSystemTemplateSignalGroupRef=MsgGr_FD_P1_HTCU_07_100ms
          4 x ComGroupSignal, all with category=TOOL_CONFIGURED, ComSignalEndianness=LITTLE_ENDIAN:
            FD_P1_HTCU_07_100ms_HTCU_Crc7Val: ComBitPosition=0, ComTransferProperty=PENDING, ComSignalInitValue=65535, ComBitSize=16, ComSignalLength=2, ComSignalType=UINT16, ComHandleId=26, ComSystemTemplateSystemSignalRef=HTCU_Crc7Val
            FD_P1_HTCU_07_100ms_HTCU_AlvCnt7Val: ComBitPosition=16, ComTransferProperty=PENDING, ComSignalInitValue=0, ComBitSize=8, ComSignalLength=1, ComSignalType=UINT8, ComHandleId=27, ComSystemTemplateSystemSignalRef=HTCU_AlvCnt7Val
            FD_P1_HTCU_07_100ms_HTCU_GearSlctrDisBlinkReq: ComBitPosition=74, ComTransferProperty=PENDING, ComSignalInitValue=0, ComBitSize=2, ComSignalLength=1, ComSignalType=UINT8, ComHandleId=28, ComSystemTemplateSystemSignalRef=HTCU_GearSlctrDisBlinkReq
            FD_P1_HTCU_07_100ms_HTCU_07_100ms_E2EReserved: ComBitPosition=127, ComSignalInitValue=0, ComBitSize=1, ComSignalLength=1, ComSignalType=BOOLEAN, ComHandleId=29, ComSystemTemplateSystemSignalRef=HTCU_07_100ms_E2EReserved
        ComISignalGroup_MsgGr_E2E_FD_P1_PDC_FD_03_200ms: ComHandleId=18, ComTimeout=1.5, ComTransferProperty=TRIGGERED_ON_CHANGE, ComSystemTemplateSignalGroupRef=MsgGr_FD_P1_PDC_FD_03_200ms
          7 x ComGroupSignal, all with category=TOOL_CONFIGURED, ComSignalEndianness=LITTLE_ENDIAN:
            FD_P1_PDC_FD_03_200ms_PDC_FD_Crc3Val: ComBitPosition=0, ComTransferProperty=PENDING, ComSignalInitValue=65535, ComBitSize=16, ComSignalLength=2, ComSignalType=UINT16, ComHandleId=59, ComSystemTemplateSystemSignalRef=PDC_FD_Crc3Val
            FD_P1_PDC_FD_03_200ms_PDC_FD_AlvCnt3Val: ComBitPosition=16, ComTransferProperty=PENDING, ComSignalInitValue=0, ComBitSize=8, ComSignalLength=1, ComSignalType=UINT8, ComHandleId=60, ComSystemTemplateSystemSignalRef=PDC_FD_AlvCnt3Val
            FD_P1_PDC_FD_03_200ms_Warn_DrvDrSwSta: ComBitPosition=64, ComTransferProperty=TRIGGERED_ON_CHANGE, ComSignalInitValue=0, ComBitSize=2, ComSignalLength=1, ComSignalType=UINT8, ComHandleId=61, ComSystemTemplateSystemSignalRef=Warn_DrvDrSwSta
            FD_P1_PDC_FD_03_200ms_Warn_AsstDrSwSta: ComBitPosition=66, ComTransferProperty=TRIGGERED_ON_CHANGE, ComSignalInitValue=0, ComBitSize=2, ComSignalLength=1, ComSignalType=UINT8, ComHandleId=62, ComSystemTemplateSystemSignalRef=Warn_AsstDrSwSta
            FD_P1_PDC_FD_03_200ms_Warn_RrLftDrSwSta: ComBitPosition=68, ComTransferProperty=TRIGGERED_ON_CHANGE, ComSignalInitValue=0, ComBitSize=2, ComSignalLength=1, ComSignalType=UINT8, ComHandleId=63, ComSystemTemplateSystemSignalRef=Warn_RrLftDrSwSta
            FD_P1_PDC_FD_03_200ms_Warn_RrRtDrSwSta: ComBitPosition=70, ComTransferProperty=TRIGGERED_ON_CHANGE, ComSignalInitValue=0, ComBitSize=2, ComSignalLength=1, ComSignalType=UINT8, ComHandleId=64, ComSystemTemplateSystemSignalRef=Warn_RrRtDrSwSta
            FD_P1_PDC_FD_03_200ms_PDC_FD_03_200ms_E2EReserved: ComBitPosition=127, ComSignalInitValue=0, ComBitSize=1, ComSignalLength=1, ComSignalType=BOOLEAN, ComHandleId=65, ComSystemTemplateSystemSignalRef=PDC_FD_03_200ms_E2EReserved
        ComISignalGroup_MsgGr_E2E_FD_P1_PDC_FD_15_300ms: ComHandleId=3, ComTimeout=1.5, ComTransferProperty=TRIGGERED_ON_CHANGE, ComSystemTemplateSignalGroupRef=MsgGr_FD_P1_PDC_FD_15_300ms
          5 x ComGroupSignal, all with category=TOOL_CONFIGURED, ComSignalEndianness=LITTLE_ENDIAN:
            FD_P1_PDC_FD_15_300ms_PDC_FD_Crc15Val: ComBitPosition=0, ComTransferProperty=PENDING, ComSignalInitValue=65535, ComBitSize=16, ComSignalLength=2, ComSignalType=UINT16, ComHandleId=21, ComSystemTemplateSystemSignalRef=PDC_FD_Crc15Val
            FD_P1_PDC_FD_15_300ms_PDC_FD_AlvCnt15Val: ComBitPosition=16, ComTransferProperty=PENDING, ComSignalInitValue=0, ComBitSize=8, ComSignalLength=1, ComSignalType=UINT8, ComHandleId=22, ComSystemTemplateSystemSignalRef=PDC_FD_AlvCnt15Val
            FD_P1_PDC_FD_15_300ms_PDC_ResetPreWrngForOthers: ComBitPosition=42, ComTransferProperty=TRIGGERED_ON_CHANGE, ComSignalInitValue=0, ComBitSize=2, ComSignalLength=1, ComSignalType=UINT8, ComHandleId=23, ComSystemTemplateSystemSignalRef=PDC_ResetPreWrngForOthers
            FD_P1_PDC_FD_15_300ms_PDC_ResetReqForOthers: ComBitPosition=46, ComTransferProperty=TRIGGERED_ON_CHANGE, ComSignalInitValue=0, ComBitSize=2, ComSignalLength=1, ComSignalType=UINT8, ComHandleId=24, ComSystemTemplateSystemSignalRef=PDC_ResetReqForOthers
            FD_P1_PDC_FD_15_300ms_PDC_FD_15_300ms_E2EReserved: ComBitPosition=255, ComSignalInitValue=0, ComBitSize=1, ComSignalLength=1, ComSignalType=BOOLEAN, ComHandleId=25, ComSystemTemplateSystemSignalRef=PDC_FD_15_300ms_E2EReserved
        ComISignalGroup_MsgGr_E2E_FD_P1_PRAC_01_300ms: ComHandleId=29, ComTimeout=1.5, ComTransferProperty=TRIGGERED_ON_CHANGE, ComSystemTemplateSignalGroupRef=MsgGr_FD_P1_PRAC_01_300ms
          11 x ComGroupSignal, all with category=TOOL_CONFIGURED, ComSignalEndianness=LITTLE_ENDIAN:
            FD_P1_PRAC_01_300ms_PRAC_Crc1Val: ComBitPosition=0, ComTransferProperty=PENDING, ComSignalInitValue=65535, ComBitSize=16, ComSignalLength=2, ComSignalType=UINT16, ComHandleId=101, ComSystemTemplateSystemSignalRef=PRAC_Crc1Val
            FD_P1_PRAC_01_300ms_PRAC_AlvCnt1Val: ComBitPosition=16, ComTransferProperty=PENDING, ComSignalInitValue=0, ComBitSize=8, ComSignalLength=1, ComSignalType=UINT8, ComHandleId=102, ComSystemTemplateSystemSignalRef=PRAC_AlvCnt1Val
            FD_P1_PRAC_01_300ms_PRAC_PrkngReleaseSta: ComBitPosition=28, ComTransferProperty=TRIGGERED_ON_CHANGE, ComSignalInitValue=0, ComBitSize=2, ComSignalLength=1, ComSignalType=UINT8, ComHandleId=103, ComSystemTemplateSystemSignalRef=PRAC_PrkngReleaseSta
            FD_P1_PRAC_01_300ms_PRAC_BrkSwSta: ComBitPosition=30, ComTransferProperty=TRIGGERED_ON_CHANGE, ComSignalInitValue=0, ComBitSize=2, ComSignalLength=1, ComSignalType=UINT8, ComHandleId=104, ComSystemTemplateSystemSignalRef=PRAC_BrkSwSta
            FD_P1_PRAC_01_300ms_PRAC_NPrkFuncSta: ComBitPosition=32, ComTransferProperty=TRIGGERED_ON_CHANGE, ComSignalInitValue=0, ComBitSize=2, ComSignalLength=1, ComSignalType=UINT8, ComHandleId=105, ComSystemTemplateSystemSignalRef=PRAC_NPrkFuncSta
            FD_P1_PRAC_01_300ms_PRAC_NWFuncSta: ComBitPosition=34, ComTransferProperty=TRIGGERED_ON_CHANGE, ComSignalInitValue=0, ComBitSize=2, ComSignalLength=1, ComSignalType=UINT8, ComHandleId=106, ComSystemTemplateSystemSignalRef=PRAC_NWFuncSta
            FD_P1_PRAC_01_300ms_PRAC_WrngSndSta: ComBitPosition=44, ComTransferProperty=TRIGGERED_ON_CHANGE, ComSignalInitValue=0, ComBitSize=3, ComSignalLength=1, ComSignalType=UINT8, ComHandleId=107, ComSystemTemplateSystemSignalRef=PRAC_WrngSndSta
            FD_P1_PRAC_01_300ms_PRAC_PNSta: ComBitPosition=50, ComTransferProperty=TRIGGERED_ON_CHANGE, ComSignalInitValue=0, ComBitSize=2, ComSignalLength=1, ComSignalType=UINT8, ComHandleId=108, ComSystemTemplateSystemSignalRef=PRAC_PNSta
            FD_P1_PRAC_01_300ms_PRAC_PRAErrSta: ComBitPosition=64, ComTransferProperty=TRIGGERED_ON_CHANGE, ComSignalInitValue=0, ComBitSize=16, ComSignalLength=2, ComSignalType=UINT16, ComHandleId=109, ComSystemTemplateSystemSignalRef=PRAC_PRAErrSta
            FD_P1_PRAC_01_300ms_PRAC_PRAWrngSta: ComBitPosition=80, ComTransferProperty=TRIGGERED_ON_CHANGE, ComSignalInitValue=0, ComBitSize=4, ComSignalLength=1, ComSignalType=UINT8, ComHandleId=110, ComSystemTemplateSystemSignalRef=PRAC_PRAWrngSta
            FD_P1_PRAC_01_300ms_PRAC_01_300ms_E2EReserved: ComBitPosition=127, ComSignalInitValue=0, ComBitSize=1, ComSignalLength=1, ComSignalType=BOOLEAN, ComHandleId=111, ComSystemTemplateSystemSignalRef=PRAC_01_300ms_E2EReserved
        ComISignalGroup_MsgGr_E2E_FD_P1_SBW_SHFTR_FF_01_10ms: ComHandleId=2, ComTransferProperty=PENDING, ComNotification=Rte_COMCbkTAck_ComISignalGroup_MsgGr_E2E_FD_P1_SBW_SHFTR_FF_01_10ms, ComErrorNotification=Rte_COMCbkTErr_ComISignalGroup_MsgGr_E2E_FD_P1_SBW_SHFTR_FF_01_10ms, ComTimeout=0.0, ComSystemTemplateSignalGroupRef=MsgGr_FD_P1_SBW_SHFTR_FF_01_10ms
          21 x ComGroupSignal, all with category=TOOL_CONFIGURED, ComSignalEndianness=LITTLE_ENDIAN:
            FD_P1_SBW_SHFTR_FF_01_10ms_SBW_SHFTR_FF_Crc1Val: ComBitPosition=0, ComTransferProperty=PENDING, ComSignalInitValue=65535, ComBitSize=16, ComSignalLength=2, ComSignalType=UINT16, ComHandleId=30, ComSystemTemplateSystemSignalRef=SBW_SHFTR_FF_Crc1Val
            FD_P1_SBW_SHFTR_FF_01_10ms_SBW_SHFTR_FF_AlvCnt1Val: ComBitPosition=16, ComTransferProperty=PENDING, ComSignalInitValue=0, ComBitSize=8, ComSignalLength=1, ComSignalType=UINT8, ComHandleId=31, ComSystemTemplateSystemSignalRef=SBW_SHFTR_FF_AlvCnt1Val
            FD_P1_SBW_SHFTR_FF_01_10ms_SBW_SHFTR_FF_LvrTyp: ComBitPosition=24, ComTransferProperty=PENDING, ComSignalInitValue=0, ComBitSize=3, ComSignalLength=1, ComSignalType=UINT8, ComHandleId=32, ComSystemTemplateSystemSignalRef=SBW_SHFTR_FF_LvrTyp
            FD_P1_SBW_SHFTR_FF_01_10ms_SBW_SHFTR_FF_ResetOpSta: ComBitPosition=28, ComTransferProperty=PENDING, ComSignalInitValue=0, ComBitSize=2, ComSignalLength=1, ComSignalType=UINT8, ComHandleId=33, ComSystemTemplateSystemSignalRef=SBW_SHFTR_FF_ResetOpSta
            FD_P1_SBW_SHFTR_FF_01_10ms_SBW_SHFTR_FF_AutoHoldBtnSta: ComBitPosition=30, ComTransferProperty=PENDING, ComSignalInitValue=0, ComBitSize=2, ComSignalLength=1, ComSignalType=UINT8, ComHandleId=34, ComSystemTemplateSystemSignalRef=SBW_SHFTR_FF_AutoHoldBtnSta
            FD_P1_SBW_SHFTR_FF_01_10ms_SBW_SHFTR_FF_P_Sta: ComBitPosition=32, ComTransferProperty=PENDING, ComSignalInitValue=0, ComBitSize=2, ComSignalLength=1, ComSignalType=UINT8, ComHandleId=35, ComSystemTemplateSystemSignalRef=SBW_SHFTR_FF_P_Sta
            FD_P1_SBW_SHFTR_FF_01_10ms_SBW_SHFTR_FF_R_Sta: ComBitPosition=34, ComTransferProperty=PENDING, ComSignalInitValue=0, ComBitSize=2, ComSignalLength=1, ComSignalType=UINT8, ComHandleId=36, ComSystemTemplateSystemSignalRef=SBW_SHFTR_FF_R_Sta
            FD_P1_SBW_SHFTR_FF_01_10ms_SBW_SHFTR_FF_N_Sta: ComBitPosition=36, ComTransferProperty=PENDING, ComSignalInitValue=0, ComBitSize=2, ComSignalLength=1, ComSignalType=UINT8, ComHandleId=37, ComSystemTemplateSystemSignalRef=SBW_SHFTR_FF_N_Sta
            FD_P1_SBW_SHFTR_FF_01_10ms_SBW_SHFTR_FF_D_Sta: ComBitPosition=38, ComTransferProperty=PENDING, ComSignalInitValue=0, ComBitSize=2, ComSignalLength=1, ComSignalType=UINT8, ComHandleId=38, ComSystemTemplateSystemSignalRef=SBW_SHFTR_FF_D_Sta
            FD_P1_SBW_SHFTR_FF_01_10ms_SBW_SHFTR_FF_LvrPosInfo: ComBitPosition=40, ComTransferProperty=PENDING, ComSignalInitValue=0, ComBitSize=4, ComSignalLength=1, ComSignalType=UINT8, ComHandleId=39, ComSystemTemplateSystemSignalRef=SBW_SHFTR_FF_LvrPosInfo
            FD_P1_SBW_SHFTR_FF_01_10ms_SBW_SHFTR_FF_PReleaseBtnSta: ComBitPosition=44, ComTransferProperty=PENDING, ComSignalInitValue=0, ComBitSize=2, ComSignalLength=1, ComSignalType=UINT8, ComHandleId=40, ComSystemTemplateSystemSignalRef=SBW_SHFTR_FF_PReleaseBtnSta
            FD_P1_SBW_SHFTR_FF_01_10ms_SBW_SHFTR_FF_UnlckBtnSta: ComBitPosition=46, ComTransferProperty=PENDING, ComSignalInitValue=0, ComBitSize=2, ComSignalLength=1, ComSignalType=UINT8, ComHandleId=41, ComSystemTemplateSystemSignalRef=SBW_SHFTR_FF_UnlckBtnSta
            FD_P1_SBW_SHFTR_FF_01_10ms_SBW_SHFTR_FF_LvrWrngMsg: ComBitPosition=56, ComTransferProperty=PENDING, ComSignalInitValue=0, ComBitSize=5, ComSignalLength=1, ComSignalType=UINT8, ComHandleId=42, ComSystemTemplateSystemSignalRef=SBW_SHFTR_FF_LvrWrngMsg
            FD_P1_SBW_SHFTR_FF_01_10ms_SBW_SHFTR_FF_LvrUnitSta: ComBitPosition=61, ComTransferProperty=PENDING, ComSignalInitValue=0, ComBitSize=3, ComSignalLength=1, ComSignalType=UINT8, ComHandleId=43, ComSystemTemplateSystemSignalRef=SBW_SHFTR_FF_LvrUnitSta
            FD_P1_SBW_SHFTR_FF_01_10ms_SBW_SHFTR_FF_LvrIndicatorSta: ComBitPosition=64, ComTransferProperty=PENDING, ComSignalInitValue=0, ComBitSize=8, ComSignalLength=1, ComSignalType=UINT8, ComHandleId=44, ComSystemTemplateSystemSignalRef=SBW_SHFTR_FF_LvrIndicatorSta
            FD_P1_SBW_SHFTR_FF_01_10ms_SBW_SHFTR_FF_USM_ModeChangeSta: ComBitPosition=72, ComTransferProperty=PENDING, ComSignalInitValue=0, ComBitSize=2, ComSignalLength=1, ComSignalType=UINT8, ComHandleId=45, ComSystemTemplateSystemSignalRef=SBW_SHFTR_FF_USM_ModeChangeSta
            FD_P1_SBW_SHFTR_FF_01_10ms_SBW_SHFTR_FF_ModePosInfo: ComBitPosition=74, ComTransferProperty=PENDING, ComSignalInitValue=0, ComBitSize=2, ComSignalLength=1, ComSignalType=UINT8, ComHandleId=46, ComSystemTemplateSystemSignalRef=SBW_SHFTR_FF_ModePosInfo
            FD_P1_SBW_SHFTR_FF_01_10ms_Reprogram_State_SBW_FF: ComBitPosition=76, ComTransferProperty=PENDING, ComSignalInitValue=3, ComBitSize=2, ComSignalLength=1, ComSignalType=UINT8, ComHandleId=47, ComSystemTemplateSystemSignalRef=Reprogram_State_SBW_FF
            FD_P1_SBW_SHFTR_FF_01_10ms_SBW_SHFTR_FF_01_10ms_E2EReserved: ComBitPosition=127, ComSignalInitValue=0, ComBitSize=1, ComSignalLength=1, ComSignalType=BOOLEAN, ComHandleId=50, ComSystemTemplateSystemSignalRef=SBW_SHFTR_FF_01_10ms_E2EReserved
            FD_P1_SBW_SHFTR_FF_01_10ms_SBW_SHFTR_FF_RelayStatus: ComBitPosition=78, ComTransferProperty=PENDING, ComSignalInitValue=0, ComBitSize=2, ComSignalLength=1, ComSignalType=UINT8, ComHandleId=48, ComSystemTemplateSystemSignalRef=SBW_SHFTR_FF_RelayStatus
            FD_P1_SBW_SHFTR_FF_01_10ms_SBW_SHFTR_FF_EpbSta4VcuReq: ComBitPosition=80, ComTransferProperty=PENDING, ComSignalInitValue=0, ComBitSize=3, ComSignalLength=1, ComSignalType=UINT8, ComHandleId=49, ComSystemTemplateSystemSignalRef=SBW_SHFTR_FF_EpbSta4VcuReq
        ComISignalGroup_MsgGr_E2E_FD_P1_SCU_FF_01_10ms: ComHandleId=13, ComTimeout=0.5, ComTransferProperty=PENDING, ComSystemTemplateSignalGroupRef=MsgGr_FD_P1_SCU_FF_01_10ms
          5 x ComGroupSignal, all with category=TOOL_CONFIGURED, ComSignalEndianness=LITTLE_ENDIAN:
            FD_P1_SCU_FF_01_10ms_SCU_FF_Crc1Val: ComBitPosition=0, ComTransferProperty=PENDING, ComSignalInitValue=65535, ComBitSize=16, ComSignalLength=2, ComSignalType=UINT16, ComHandleId=49, ComSystemTemplateSystemSignalRef=SCU_FF_Crc1Val
            FD_P1_SCU_FF_01_10ms_SCU_FF_AlvCnt1Val: ComBitPosition=16, ComTransferProperty=PENDING, ComSignalInitValue=0, ComBitSize=8, ComSignalLength=1, ComSignalType=UINT8, ComHandleId=50, ComSystemTemplateSystemSignalRef=SCU_FF_AlvCnt1Val
            FD_P1_SCU_FF_01_10ms_SCU_FF_PosActSta: ComBitPosition=24, ComTransferProperty=PENDING, ComSignalInitValue=9, ComBitSize=4, ComSignalLength=1, ComSignalType=UINT8, ComHandleId=51, ComSystemTemplateSystemSignalRef=SCU_FF_PosActSta
            FD_P1_SCU_FF_01_10ms_SCU_FF_PosTarSta: ComBitPosition=39, ComTransferProperty=PENDING, ComSignalInitValue=9, ComBitSize=4, ComSignalLength=1, ComSignalType=UINT8, ComHandleId=52, ComSystemTemplateSystemSignalRef=SCU_FF_PosTarSta
            FD_P1_SCU_FF_01_10ms_SCU_FF_01_10ms_E2EReserved: ComBitPosition=63, ComSignalInitValue=0, ComBitSize=1, ComSignalLength=1, ComSignalType=BOOLEAN, ComHandleId=53, ComSystemTemplateSystemSignalRef=SCU_FF_01_10ms_E2EReserved
        ComISignalGroup_MsgGr_E2E_FD_P1_TCU_01_10ms: ComHandleId=6, ComTimeout=0.5, ComTransferProperty=PENDING, ComSystemTemplateSignalGroupRef=MsgGr_FD_P1_TCU_01_10ms
          7 x ComGroupSignal, all with category=TOOL_CONFIGURED, ComSignalEndianness=LITTLE_ENDIAN:
            FD_P1_TCU_01_10ms_TCU_Crc1Val: ComBitPosition=0, ComTransferProperty=PENDING, ComSignalInitValue=65535, ComBitSize=16, ComSignalLength=2, ComSignalType=UINT16, ComHandleId=31, ComSystemTemplateSystemSignalRef=TCU_Crc1Val
            FD_P1_TCU_01_10ms_TCU_AlvCnt1Val: ComBitPosition=16, ComTransferProperty=PENDING, ComSignalInitValue=0, ComBitSize=8, ComSignalLength=1, ComSignalType=UINT8, ComHandleId=32, ComSystemTemplateSystemSignalRef=TCU_AlvCnt1Val
            FD_P1_TCU_01_10ms_TCU_GearSlctDis: ComBitPosition=32, ComTransferProperty=PENDING, ComSignalInitValue=9, ComBitSize=4, ComSignalLength=1, ComSignalType=UINT8, ComHandleId=33, ComSystemTemplateSystemSignalRef=TCU_GearSlctDis
            FD_P1_TCU_01_10ms_TCU_VehSpdKphVal: ComBitPosition=96, ComTransferProperty=PENDING, ComSignalInitValue=0, ComBitSize=8, ComSignalLength=1, ComSignalType=UINT8, ComHandleId=34, ComSystemTemplateSystemSignalRef=TCU_VehSpdKphVal
            FD_P1_TCU_01_10ms_TCU_DcmlVehSpdKphVal: ComBitPosition=104, ComTransferProperty=PENDING, ComSignalInitValue=0, ComBitSize=8, ComSignalLength=1, ComSignalType=UINT8, ComHandleId=35, ComSystemTemplateSystemSignalRef=TCU_DcmlVehSpdKphVal
            FD_P1_TCU_01_10ms_TCU_GearLmpBlnkngReq: ComBitPosition=122, ComTransferProperty=PENDING, ComSignalInitValue=0, ComBitSize=2, ComSignalLength=1, ComSignalType=UINT8, ComHandleId=36, ComSystemTemplateSystemSignalRef=TCU_GearLmpBlnkngReq
            FD_P1_TCU_01_10ms_TCU_01_10ms_E2EReserved: ComBitPosition=255, ComSignalInitValue=0, ComBitSize=1, ComSignalLength=1, ComSignalType=BOOLEAN, ComHandleId=37, ComSystemTemplateSystemSignalRef=TCU_01_10ms_E2EReserved
        ComISignalGroup_MsgGr_E2E_FD_P1_TCU_02_10ms: ComHandleId=26, ComTimeout=0.5, ComTransferProperty=PENDING, ComSystemTemplateSignalGroupRef=MsgGr_FD_P1_TCU_02_10ms
          4 x ComGroupSignal, all with category=TOOL_CONFIGURED, ComSignalEndianness=LITTLE_ENDIAN:
            FD_P1_TCU_02_10ms_TCU_Crc2Val: ComBitPosition=0, ComTransferProperty=PENDING, ComSignalInitValue=65535, ComBitSize=16, ComSignalLength=2, ComSignalType=UINT16, ComHandleId=81, ComSystemTemplateSystemSignalRef=TCU_Crc2Val
            FD_P1_TCU_02_10ms_TCU_AlvCnt2Val: ComBitPosition=16, ComTransferProperty=PENDING, ComSignalInitValue=0, ComBitSize=8, ComSignalLength=1, ComSignalType=UINT8, ComHandleId=82, ComSystemTemplateSystemSignalRef=TCU_AlvCnt2Val
            FD_P1_TCU_02_10ms_TCU_PrkReleaseReq: ComBitPosition=64, ComTransferProperty=PENDING, ComSignalInitValue=0, ComBitSize=2, ComSignalLength=1, ComSignalType=UINT8, ComHandleId=83, ComSystemTemplateSystemSignalRef=TCU_PrkReleaseReq
            FD_P1_TCU_02_10ms_TCU_02_10ms_E2EReserved: ComBitPosition=255, ComSignalInitValue=0, ComBitSize=1, ComSignalLength=1, ComSignalType=BOOLEAN, ComHandleId=84, ComSystemTemplateSystemSignalRef=TCU_02_10ms_E2EReserved
        ComISignalGroup_MsgGr_E2E_FD_P1_VCU_01_10ms: ComHandleId=33, ComTimeout=0.5, ComTransferProperty=PENDING, ComSystemTemplateSignalGroupRef=MsgGr_FD_P1_VCU_01_10ms
          5 x ComGroupSignal, all with category=TOOL_CONFIGURED, ComSignalEndianness=LITTLE_ENDIAN:
            FD_P1_VCU_01_10ms_VCU_Crc1Val: ComBitPosition=0, ComTransferProperty=PENDING, ComSignalInitValue=65535, ComBitSize=16, ComSignalLength=2, ComSignalType=UINT16, ComHandleId=119, ComSystemTemplateSystemSignalRef=VCU_Crc1Val
            FD_P1_VCU_01_10ms_VCU_AlvCnt1Val: ComBitPosition=16, ComTransferProperty=PENDING, ComSignalInitValue=0, ComBitSize=8, ComSignalLength=1, ComSignalType=UINT8, ComHandleId=120, ComSystemTemplateSystemSignalRef=VCU_AlvCnt1Val
            FD_P1_VCU_01_10ms_VCU_EvDrvRdySta: ComBitPosition=28, ComTransferProperty=PENDING, ComSignalInitValue=0, ComBitSize=2, ComSignalLength=1, ComSignalType=UINT8, ComHandleId=121, ComSystemTemplateSystemSignalRef=VCU_EvDrvRdySta
            FD_P1_VCU_01_10ms_VCU_GearPosSta: ComBitPosition=32, ComTransferProperty=PENDING, ComSignalInitValue=9, ComBitSize=4, ComSignalLength=1, ComSignalType=UINT8, ComHandleId=122, ComSystemTemplateSystemSignalRef=VCU_GearPosSta
            FD_P1_VCU_01_10ms_VCU_01_10ms_E2EReserved: ComBitPosition=255, ComSignalInitValue=0, ComBitSize=1, ComSignalLength=1, ComSignalType=BOOLEAN, ComHandleId=123, ComSystemTemplateSystemSignalRef=VCU_01_10ms_E2EReserved
      ComIPdu_FD_P2_SBW_SHFTR_FF_01_10ms_back (ComIPdu):
        category = TOOL_CONFIGURED
        ComIPduDirection = SEND
        ComIPduHandleId = 1
        ComIPduType = NORMAL
        ComIPduSignalProcessing = DEFERRED
        ComIPduSignalGroupRef = ComISignalGroup_MsgGr_E2E_FD_P2_SBW_SHFTR_FF_01_10ms_back
        ComPduIdRef = Pdu_ISignalIPdu_FD_P2_SBW_SHFTR_FF_01_10ms_back
        ComIPduGroupRef = ComIPduGroupTx_SBW_FD_P2
        ComTxIpdu_ComIPdu_FD_P2_SBW_SHFTR_FF_01_10ms_back (ComTxIPdu): category=TOOL_CONFIGURED, ComTxIPduUnusedAreasDefault=0, ComMinimumDelayTime=0.0
          ComTxModeTrue_ComTxIpdu_ComIPdu_FD_P2_SBW_SHFTR_FF_01_10ms_back (ComTxModeTrue): category=TOOL_CONFIGURED
            ComTxMode_ComTxModeTrue_ComTxIpdu_ComIPdu_FD_P2_SBW_SHFTR_FF_01_10ms_back (ComTxMode): category=TOOL_CONFIGURED, ComTxModeTimeOffset=0.0, ComTxModeTimePeriod=0.01, ComTxModeMode=PERIODIC
      ComIPdu_FD_P2_SCU_FF_01_10ms_back (ComIPdu):
        category = TOOL_CONFIGURED
        ComIPduDirection = RECEIVE
        ComIPduHandleId = 37
        ComIPduType = NORMAL
        ComIPduSignalProcessing = DEFERRED
        ComIPduSignalGroupRef = ComISignalGroup_MsgGr_E2E_FD_P2_SCU_FF_01_10ms_back
        ComPduIdRef = Pdu_ISignalIPdu_FD_P2_SCU_FF_01_10ms_back
        ComIPduGroupRef = ComIPduGroupRx_SBW_FD_P2
      29 x ComSignalGroup, all with category=TOOL_CONFIGURED:
        ComISignalGroup_MsgGr_E2E_FD_P2_SBW_SHFTR_FF_01_10ms_back: ComHandleId=1, ComSignalGroupArrayAccess=1, ComTransferProperty=PENDING, ComSystemTemplateSignalGroupRef=MsgGr_FD_P2_SBW_SHFTR_FF_01_10ms_back
          21 x ComGroupSignal, all with category=TOOL_CONFIGURED, ComSignalEndianness=LITTLE_ENDIAN:
            FD_P2_SBW_SHFTR_FF_01_10ms_back_SBW_SHFTR_FF_Crc1Val: ComBitPosition=0, ComTransferProperty=PENDING, ComSignalInitValue=65535, ComBitSize=16, ComSignalLength=2, ComSignalType=UINT16, ComHandleId=9, ComSystemTemplateSystemSignalRef=SBW_SHFTR_FF_Crc1Val
            FD_P2_SBW_SHFTR_FF_01_10ms_back_SBW_SHFTR_FF_AlvCnt1Val: ComBitPosition=16, ComTransferProperty=PENDING, ComSignalInitValue=0, ComBitSize=8, ComSignalLength=1, ComSignalType=UINT8, ComHandleId=10, ComSystemTemplateSystemSignalRef=SBW_SHFTR_FF_AlvCnt1Val
            FD_P2_SBW_SHFTR_FF_01_10ms_back_SBW_SHFTR_FF_LvrTyp: ComBitPosition=24, ComTransferProperty=PENDING, ComSignalInitValue=0, ComBitSize=3, ComSignalLength=1, ComSignalType=UINT8, ComHandleId=11, ComSystemTemplateSystemSignalRef=SBW_SHFTR_FF_LvrTyp
            FD_P2_SBW_SHFTR_FF_01_10ms_back_SBW_SHFTR_FF_P_Sta: ComBitPosition=32, ComTransferProperty=PENDING, ComSignalInitValue=0, ComBitSize=2, ComSignalLength=1, ComSignalType=UINT8, ComHandleId=14, ComSystemTemplateSystemSignalRef=SBW_SHFTR_FF_P_Sta
            FD_P2_SBW_SHFTR_FF_01_10ms_back_SBW_SHFTR_FF_R_Sta: ComBitPosition=34, ComTransferProperty=PENDING, ComSignalInitValue=0, ComBitSize=2, ComSignalLength=1, ComSignalType=UINT8, ComHandleId=15, ComSystemTemplateSystemSignalRef=SBW_SHFTR_FF_R_Sta
            FD_P2_SBW_SHFTR_FF_01_10ms_back_SBW_SHFTR_FF_N_Sta: ComBitPosition=36, ComTransferProperty=PENDING, ComSignalInitValue=0, ComBitSize=2, ComSignalLength=1, ComSignalType=UINT8, ComHandleId=16, ComSystemTemplateSystemSignalRef=SBW_SHFTR_FF_N_Sta
            FD_P2_SBW_SHFTR_FF_01_10ms_back_SBW_SHFTR_FF_D_Sta: ComBitPosition=38, ComTransferProperty=PENDING, ComSignalInitValue=0, ComBitSize=2, ComSignalLength=1, ComSignalType=UINT8, ComHandleId=17, ComSystemTemplateSystemSignalRef=SBW_SHFTR_FF_D_Sta
            FD_P2_SBW_SHFTR_FF_01_10ms_back_SBW_SHFTR_FF_LvrPosInfo: ComBitPosition=40, ComTransferProperty=PENDING, ComSignalInitValue=0, ComBitSize=4, ComSignalLength=1, ComSignalType=UINT8, ComHandleId=18, ComSystemTemplateSystemSignalRef=SBW_SHFTR_FF_LvrPosInfo
            FD_P2_SBW_SHFTR_FF_01_10ms_back_SBW_SHFTR_FF_PReleaseBtnSta: ComBitPosition=44, ComTransferProperty=PENDING, ComSignalInitValue=0, ComBitSize=2, ComSignalLength=1, ComSignalType=UINT8, ComHandleId=19, ComSystemTemplateSystemSignalRef=SBW_SHFTR_FF_PReleaseBtnSta
            FD_P2_SBW_SHFTR_FF_01_10ms_back_SBW_SHFTR_FF_UnlckBtnSta: ComBitPosition=46, ComTransferProperty=PENDING, ComSignalInitValue=0, ComBitSize=2, ComSignalLength=1, ComSignalType=UINT8, ComHandleId=20, ComSystemTemplateSystemSignalRef=SBW_SHFTR_FF_UnlckBtnSta
            FD_P2_SBW_SHFTR_FF_01_10ms_back_SBW_SHFTR_FF_LvrWrngMsg: ComBitPosition=56, ComTransferProperty=PENDING, ComSignalInitValue=0, ComBitSize=5, ComSignalLength=1, ComSignalType=UINT8, ComHandleId=21, ComSystemTemplateSystemSignalRef=SBW_SHFTR_FF_LvrWrngMsg
            FD_P2_SBW_SHFTR_FF_01_10ms_back_SBW_SHFTR_FF_LvrUnitSta: ComBitPosition=61, ComTransferProperty=PENDING, ComSignalInitValue=0, ComBitSize=3, ComSignalLength=1, ComSignalType=UINT8, ComHandleId=22, ComSystemTemplateSystemSignalRef=SBW_SHFTR_FF_LvrUnitSta
            FD_P2_SBW_SHFTR_FF_01_10ms_back_SBW_SHFTR_FF_LvrIndicatorSta: ComBitPosition=64, ComTransferProperty=PENDING, ComSignalInitValue=0, ComBitSize=8, ComSignalLength=1, ComSignalType=UINT8, ComHandleId=23, ComSystemTemplateSystemSignalRef=SBW_SHFTR_FF_LvrIndicatorSta
            FD_P2_SBW_SHFTR_FF_01_10ms_back_SBW_SHFTR_FF_01_10ms_back_E2EReserved: ComBitPosition=127, ComSignalInitValue=0, ComBitSize=1, ComSignalLength=1, ComSignalType=BOOLEAN, ComHandleId=29, ComSystemTemplateSystemSignalRef=SBW_SHFTR_FF_01_10ms_back_E2EReserved
            FD_P2_SBW_SHFTR_FF_01_10ms_back_SBW_SHFTR_FF_ResetOpSta: ComBitPosition=28, ComTransferProperty=PENDING, ComSignalInitValue=0, ComBitSize=2, ComSignalLength=1, ComSignalType=UINT8, ComHandleId=12, ComSystemTemplateSystemSignalRef=SBW_SHFTR_FF_ResetOpSta
            FD_P2_SBW_SHFTR_FF_01_10ms_back_SBW_SHFTR_FF_AutoHoldBtnSta: ComBitPosition=30, ComTransferProperty=PENDING, ComSignalInitValue=0, ComBitSize=2, ComSignalLength=1, ComSignalType=UINT8, ComHandleId=13, ComSystemTemplateSystemSignalRef=SBW_SHFTR_FF_AutoHoldBtnSta
            FD_P2_SBW_SHFTR_FF_01_10ms_back_SBW_SHFTR_FF_USM_ModeChangeSta: ComBitPosition=72, ComTransferProperty=PENDING, ComSignalInitValue=0, ComBitSize=2, ComSignalLength=1, ComSignalType=UINT8, ComHandleId=24, ComSystemTemplateSystemSignalRef=SBW_SHFTR_FF_USM_ModeChangeSta
            FD_P2_SBW_SHFTR_FF_01_10ms_back_SBW_SHFTR_FF_ModePosInfo: ComBitPosition=74, ComTransferProperty=PENDING, ComSignalInitValue=0, ComBitSize=2, ComSignalLength=1, ComSignalType=UINT8, ComHandleId=25, ComSystemTemplateSystemSignalRef=SBW_SHFTR_FF_ModePosInfo
            FD_P2_SBW_SHFTR_FF_01_10ms_back_Reprogram_State_SBW_FF: ComBitPosition=76, ComTransferProperty=PENDING, ComSignalInitValue=3, ComBitSize=2, ComSignalLength=1, ComSignalType=UINT8, ComHandleId=26, ComSystemTemplateSystemSignalRef=Reprogram_State_SBW_FF
            FD_P2_SBW_SHFTR_FF_01_10ms_back_SBW_SHFTR_FF_RelayStatus: ComBitPosition=78, ComTransferProperty=PENDING, ComSignalInitValue=0, ComBitSize=2, ComSignalLength=1, ComSignalType=UINT8, ComHandleId=27, ComSystemTemplateSystemSignalRef=SBW_SHFTR_FF_RelayStatus
            FD_P2_SBW_SHFTR_FF_01_10ms_back_SBW_SHFTR_FF_EpbSta4VcuReq: ComBitPosition=80, ComTransferProperty=PENDING, ComSignalInitValue=0, ComBitSize=3, ComSignalLength=1, ComSignalType=UINT8, ComHandleId=28, ComSystemTemplateSystemSignalRef=SBW_SHFTR_FF_EpbSta4VcuReq
        ComISignalGroup_MsgGr_E2E_FD_P2_SCU_FF_01_10ms_back: ComHandleId=37, ComSignalGroupArrayAccess=1, ComTimeout=0.5, ComTransferProperty=PENDING, ComSystemTemplateSignalGroupRef=MsgGr_FD_P2_SCU_FF_01_10ms_back
          5 x ComGroupSignal, all with category=TOOL_CONFIGURED, ComSignalEndianness=LITTLE_ENDIAN:
            FD_P2_SCU_FF_01_10ms_back_SCU_FF_Crc1Val: ComBitPosition=0, ComTransferProperty=PENDING, ComSignalInitValue=65535, ComBitSize=16, ComSignalLength=2, ComSignalType=UINT16, ComHandleId=130, ComSystemTemplateSystemSignalRef=SCU_FF_Crc1Val
            FD_P2_SCU_FF_01_10ms_back_SCU_FF_AlvCnt1Val: ComBitPosition=16, ComTransferProperty=PENDING, ComSignalInitValue=0, ComBitSize=8, ComSignalLength=1, ComSignalType=UINT8, ComHandleId=131, ComSystemTemplateSystemSignalRef=SCU_FF_AlvCnt1Val
            FD_P2_SCU_FF_01_10ms_back_SCU_FF_PosActSta: ComBitPosition=24, ComTransferProperty=PENDING, ComSignalInitValue=9, ComBitSize=4, ComSignalLength=1, ComSignalType=UINT8, ComHandleId=132, ComSystemTemplateSystemSignalRef=SCU_FF_PosActSta
            FD_P2_SCU_FF_01_10ms_back_SCU_FF_PosTarSta: ComBitPosition=39, ComTransferProperty=PENDING, ComSignalInitValue=9, ComBitSize=4, ComSignalLength=1, ComSignalType=UINT8, ComHandleId=133, ComSystemTemplateSystemSignalRef=SCU_FF_PosTarSta
            FD_P2_SCU_FF_01_10ms_back_SCU_FF_01_10ms_back_E2EReserved: ComBitPosition=63, ComSignalInitValue=0, ComBitSize=1, ComSignalLength=1, ComSignalType=BOOLEAN, ComHandleId=134, ComSystemTemplateSystemSignalRef=SCU_FF_01_10ms_back_E2EReserved
        ComISignalGroup_MsgGr_FD_P1_BDC_FD_02_200ms: ComHandleId=25, ComSignalGroupArrayAccess=0, ComTimeout=1.5, ComTransferProperty=TRIGGERED_ON_CHANGE, ComSystemTemplateSignalGroupRef=MsgGr_FD_P1_BDC_FD_02_200ms
          3 x ComGroupSignal, all with category=TOOL_CONFIGURED, ComSignalEndianness=LITTLE_ENDIAN, ComTransferProperty=TRIGGERED_ON_CHANGE, ComSignalInitValue=0, ComBitSize=2, ComSignalLength=1, ComSignalType=UINT8:
            FD_P1_BDC_FD_02_200ms_BCM_AccInSta: ComBitPosition=26, ComHandleId=78, ComSystemTemplateSystemSignalRef=BCM_AccInSta
            FD_P1_BDC_FD_02_200ms_BCM_Ign1InSta: ComBitPosition=28, ComHandleId=79, ComSystemTemplateSystemSignalRef=BCM_Ign1InSta
            FD_P1_BDC_FD_02_200ms_BCM_GearPosPSta: ComBitPosition=40, ComHandleId=80, ComSystemTemplateSystemSignalRef=BCM_GearPosPSta
        ComISignalGroup_MsgGr_FD_P1_BDC_FD_03_200ms: ComHandleId=21, ComSignalGroupArrayAccess=0, ComTimeout=1.5, ComTransferProperty=TRIGGERED_ON_CHANGE, ComSystemTemplateSignalGroupRef=MsgGr_FD_P1_BDC_FD_03_200ms
          FD_P1_BDC_FD_03_200ms_USM_IllAlwaysOnwithPSTNSta (ComGroupSignal):
            category = TOOL_CONFIGURED
            ComBitPosition = 85
            ComSignalEndianness = LITTLE_ENDIAN
            ComTransferProperty = TRIGGERED_ON_CHANGE
            ComSignalInitValue = 0
            ComBitSize = 3
            ComSignalLength = 1
            ComSignalType = UINT8
            ComHandleId = 69
            ComSystemTemplateSystemSignalRef = USM_IllAlwaysOnwithPSTNSta
          FD_P1_BDC_FD_03_200ms_USM_BtnIllumiAlwaysOnSta (ComGroupSignal):
            category = TOOL_CONFIGURED
            ComBitPosition = 88
            ComSignalEndianness = LITTLE_ENDIAN
            ComTransferProperty = TRIGGERED_ON_CHANGE
            ComSignalInitValue = 0
            ComBitSize = 2
            ComSignalLength = 1
            ComSignalType = UINT8
            ComHandleId = 70
            ComSystemTemplateSystemSignalRef = USM_BtnIllumiAlwaysOnSta
        ComISignalGroup_MsgGr_FD_P1_BDC_FD_04_200ms: ComHandleId=22, ComSignalGroupArrayAccess=0, ComTimeout=1.5, ComTransferProperty=TRIGGERED_ON_CHANGE, ComSystemTemplateSignalGroupRef=MsgGr_FD_P1_BDC_FD_04_200ms
          FD_P1_BDC_FD_04_200ms_BAlarm_BglrAlrm_Sta (ComGroupSignal):
            category = TOOL_CONFIGURED
            ComBitPosition = 28
            ComSignalEndianness = LITTLE_ENDIAN
            ComTransferProperty = TRIGGERED_ON_CHANGE
            ComSignalInitValue = 0
            ComBitSize = 2
            ComSignalLength = 1
            ComSignalType = UINT8
            ComHandleId = 71
            ComSystemTemplateSystemSignalRef = BAlarm_BglrAlrm_Sta
        ComISignalGroup_MsgGr_FD_P1_BDC_FD_05_200ms: ComHandleId=27, ComSignalGroupArrayAccess=0, ComTimeout=1.5, ComTransferProperty=TRIGGERED_ON_CHANGE, ComSystemTemplateSignalGroupRef=MsgGr_FD_P1_BDC_FD_05_200ms
          14 x ComGroupSignal, all with category=TOOL_CONFIGURED, ComSignalEndianness=LITTLE_ENDIAN, ComTransferProperty=TRIGGERED_ON_CHANGE, ComSignalLength=1, ComSignalType=UINT8:
            FD_P1_BDC_FD_05_200ms_Lamp_IntTailLmpOnReq: ComBitPosition=62, ComSignalInitValue=0, ComBitSize=2, ComHandleId=85, ComSystemTemplateSystemSignalRef=Lamp_IntTailLmpOnReq
            FD_P1_BDC_FD_05_200ms_Lamp_AvTailLmpSta: ComBitPosition=64, ComSignalInitValue=1, ComBitSize=2, ComHandleId=86, ComSystemTemplateSystemSignalRef=Lamp_AvTailLmpSta
            FD_P1_BDC_FD_05_200ms_Lamp_AutoLtSnsrNightSta: ComBitPosition=66, ComSignalInitValue=1, ComBitSize=2, ComHandleId=87, ComSystemTemplateSystemSignalRef=Lamp_AutoLtSnsrNightSta
            FD_P1_BDC_FD_05_200ms_MoodLamp_MdLmpFadeSta: ComBitPosition=86, ComSignalInitValue=0, ComBitSize=2, ComHandleId=88, ComSystemTemplateSystemSignalRef=MoodLamp_MdLmpFadeSta
            FD_P1_BDC_FD_05_200ms_MoodLamp_SlvColor_X: ComBitPosition=128, ComSignalInitValue=47, ComBitSize=8, ComHandleId=89, ComSystemTemplateSystemSignalRef=MoodLamp_SlvColor_X
            FD_P1_BDC_FD_05_200ms_MoodLamp_SlvColor_Y: ComBitPosition=136, ComSignalInitValue=51, ComBitSize=8, ComHandleId=90, ComSystemTemplateSystemSignalRef=MoodLamp_SlvColor_Y
            FD_P1_BDC_FD_05_200ms_MoodLamp_SlvBrgtnsVal: ComBitPosition=144, ComSignalInitValue=250, ComBitSize=8, ComHandleId=91, ComSystemTemplateSystemSignalRef=MoodLamp_SlvBrgtnsVal
            FD_P1_BDC_FD_05_200ms_MoodLamp_SlvFadeInTimetVal: ComBitPosition=152, ComSignalInitValue=10, ComBitSize=8, ComHandleId=92, ComSystemTemplateSystemSignalRef=MoodLamp_SlvFadeInTimetVal
            FD_P1_BDC_FD_05_200ms_MoodLamp_SlvFadeOutTimetVal: ComBitPosition=160, ComSignalInitValue=10, ComBitSize=8, ComHandleId=93, ComSystemTemplateSystemSignalRef=MoodLamp_SlvFadeOutTimetVal
            FD_P1_BDC_FD_05_200ms_MoodLamp_BttmSlvColor_X: ComBitPosition=195, ComSignalInitValue=47, ComBitSize=8, ComHandleId=94, ComSystemTemplateSystemSignalRef=MoodLamp_BttmSlvColor_X
            FD_P1_BDC_FD_05_200ms_MoodLamp_BttmSlvColor_Y: ComBitPosition=203, ComSignalInitValue=51, ComBitSize=8, ComHandleId=95, ComSystemTemplateSystemSignalRef=MoodLamp_BttmSlvColor_Y
            FD_P1_BDC_FD_05_200ms_MoodLamp_BttmSlvBrgtnsVal: ComBitPosition=211, ComSignalInitValue=250, ComBitSize=8, ComHandleId=96, ComSystemTemplateSystemSignalRef=MoodLamp_BttmSlvBrgtnsVal
            FD_P1_BDC_FD_05_200ms_MoodLamp_BttmSlvFadeInTimetVal: ComBitPosition=219, ComSignalInitValue=10, ComBitSize=8, ComHandleId=97, ComSystemTemplateSystemSignalRef=MoodLamp_BttmSlvFadeInTimetVal
            FD_P1_BDC_FD_05_200ms_MoodLamp_BttmSlvFadeOutTimetVal: ComBitPosition=227, ComSignalInitValue=10, ComBitSize=8, ComHandleId=98, ComSystemTemplateSystemSignalRef=MoodLamp_BttmSlvFadeOutTimetVal
        ComISignalGroup_MsgGr_FD_P1_BDC_FD_06_200ms: ComHandleId=28, ComSignalGroupArrayAccess=0, ComTimeout=1.5, ComTransferProperty=TRIGGERED_ON_CHANGE, ComSystemTemplateSignalGroupRef=MsgGr_FD_P1_BDC_FD_06_200ms
          FD_P1_BDC_FD_06_200ms_Trunk_IBU_OpnDiagSetSta (ComGroupSignal):
            category = TOOL_CONFIGURED
            ComBitPosition = 70
            ComSignalEndianness = LITTLE_ENDIAN
            ComTransferProperty = TRIGGERED_ON_CHANGE
            ComSignalInitValue = 0
            ComBitSize = 2
            ComSignalLength = 1
            ComSignalType = UINT8
            ComHandleId = 99
            ComSystemTemplateSystemSignalRef = Trunk_IBU_OpnDiagSetSta
          FD_P1_BDC_FD_06_200ms_Trunk_TrnkTlgtReleaseRly (ComGroupSignal):
            category = TOOL_CONFIGURED
            ComBitPosition = 72
            ComSignalEndianness = LITTLE_ENDIAN
            ComTransferProperty = TRIGGERED_ON_CHANGE
            ComSignalInitValue = 0
            ComBitSize = 2
            ComSignalLength = 1
            ComSignalType = UINT8
            ComHandleId = 100
            ComSystemTemplateSystemSignalRef = Trunk_TrnkTlgtReleaseRly
        ComISignalGroup_MsgGr_FD_P1_BDC_FD_RKE_01_00ms: ComHandleId=34, ComSignalGroupArrayAccess=0, ComTransferProperty=TRIGGERED_ON_CHANGE, ComTimeout=0.5, ComSystemTemplateSignalGroupRef=MsgGr_FD_P1_BDC_FD_RKE_01_00ms
          FD_P1_BDC_FD_RKE_01_00ms_RKE_BtnReq (ComGroupSignal):
            category = TOOL_CONFIGURED
            ComBitPosition = 24
            ComSignalEndianness = LITTLE_ENDIAN
            ComTransferProperty = TRIGGERED_ON_CHANGE
            ComSignalInitValue = 0
            ComBitSize = 4
            ComSignalLength = 1
            ComSignalType = UINT8
            ComHandleId = 124
            ComSystemTemplateSystemSignalRef = RKE_BtnReq
        ComISignalGroup_MsgGr_FD_P1_BDC_FD_SMK_01_00ms: ComHandleId=31, ComSignalGroupArrayAccess=0, ComTransferProperty=TRIGGERED_ON_CHANGE, ComTimeout=0.5, ComSystemTemplateSignalGroupRef=MsgGr_FD_P1_BDC_FD_SMK_01_00ms
          FD_P1_BDC_FD_SMK_01_00ms_DoorLock_PsvDrLkReq (ComGroupSignal):
            category = TOOL_CONFIGURED
            ComBitPosition = 24
            ComSignalEndianness = LITTLE_ENDIAN
            ComTransferProperty = TRIGGERED_ON_CHANGE
            ComSignalInitValue = 0
            ComBitSize = 3
            ComSignalLength = 1
            ComSignalType = UINT8
            ComHandleId = 114
            ComSystemTemplateSystemSignalRef = DoorLock_PsvDrLkReq
        ComISignalGroup_MsgGr_FD_P1_BDC_FD_SMK_02_200ms: ComHandleId=10, ComSignalGroupArrayAccess=0, ComTimeout=1.5, ComTransferProperty=TRIGGERED_ON_CHANGE, ComSystemTemplateSignalGroupRef=MsgGr_FD_P1_BDC_FD_SMK_02_200ms
          FD_P1_BDC_FD_SMK_02_200ms_SSB_StrtStpBtnSw1Sta (ComGroupSignal):
            category = TOOL_CONFIGURED
            ComBitPosition = 24
            ComSignalEndianness = LITTLE_ENDIAN
            ComTransferProperty = TRIGGERED_ON_CHANGE
            ComSignalInitValue = 0
            ComBitSize = 2
            ComSignalLength = 1
            ComSignalType = UINT8
            ComHandleId = 41
            ComSystemTemplateSystemSignalRef = SSB_StrtStpBtnSw1Sta
          FD_P1_BDC_FD_SMK_02_200ms_SSB_StrtStpBtnSw2Sta (ComGroupSignal):
            category = TOOL_CONFIGURED
            ComBitPosition = 26
            ComSignalEndianness = LITTLE_ENDIAN
            ComTransferProperty = TRIGGERED_ON_CHANGE
            ComSignalInitValue = 0
            ComBitSize = 2
            ComSignalLength = 1
            ComSignalType = UINT8
            ComHandleId = 42
            ComSystemTemplateSystemSignalRef = SSB_StrtStpBtnSw2Sta
        ComISignalGroup_MsgGr_FD_P1_BDC_FD_SMK_03_200ms: ComHandleId=11, ComSignalGroupArrayAccess=0, ComTimeout=1.5, ComTransferProperty=TRIGGERED_ON_CHANGE, ComSystemTemplateSignalGroupRef=MsgGr_FD_P1_BDC_FD_SMK_03_200ms
          5 x ComGroupSignal, all with category=TOOL_CONFIGURED, ComSignalEndianness=LITTLE_ENDIAN, ComTransferProperty=TRIGGERED_ON_CHANGE, ComSignalInitValue=0, ComSignalLength=1, ComSignalType=UINT8:
            FD_P1_BDC_FD_SMK_03_200ms_SMK_TrmnlCtrlGrpStaBDC: ComBitPosition=93, ComBitSize=3, ComHandleId=43, ComSystemTemplateSystemSignalRef=SMK_TrmnlCtrlGrpStaBDC
            FD_P1_BDC_FD_SMK_03_200ms_SMK_TrmnlCtrlGrpStaBDCEV: ComBitPosition=96, ComBitSize=3, ComHandleId=44, ComSystemTemplateSystemSignalRef=SMK_TrmnlCtrlGrpStaBDCEV
            FD_P1_BDC_FD_SMK_03_200ms_SMK_TrmnlCtrlStaBDC: ComBitPosition=99, ComBitSize=5, ComHandleId=45, ComSystemTemplateSystemSignalRef=SMK_TrmnlCtrlStaBDC
            FD_P1_BDC_FD_SMK_03_200ms_SMK_TrmnlCtrlStaBDCEV: ComBitPosition=104, ComBitSize=5, ComHandleId=46, ComSystemTemplateSystemSignalRef=SMK_TrmnlCtrlStaBDCEV
            FD_P1_BDC_FD_SMK_03_200ms_SMK_PwrOnModeSta: ComBitPosition=109, ComBitSize=2, ComHandleId=47, ComSystemTemplateSystemSignalRef=SMK_PwrOnModeSta
        ComISignalGroup_MsgGr_FD_P1_CLU_01_20ms: ComHandleId=30, ComSignalGroupArrayAccess=0, ComTimeout=0.5, ComTransferProperty=PENDING, ComSystemTemplateSignalGroupRef=MsgGr_FD_P1_CLU_01_20ms
          FD_P1_CLU_01_20ms_CLU_RhstaLvlSta (ComGroupSignal):
            category = TOOL_CONFIGURED
            ComBitPosition = 43
            ComSignalEndianness = LITTLE_ENDIAN
            ComTransferProperty = PENDING
            ComSignalInitValue = 0
            ComBitSize = 5
            ComSignalLength = 1
            ComSignalType = UINT8
            ComHandleId = 112
            ComSystemTemplateSystemSignalRef = CLU_RhstaLvlSta
          FD_P1_CLU_01_20ms_CLU_AutoBrightSta (ComGroupSignal):
            category = TOOL_CONFIGURED
            ComBitPosition = 79
            ComSignalEndianness = LITTLE_ENDIAN
            ComTransferProperty = PENDING
            ComSignalInitValue = 0
            ComBitSize = 8
            ComSignalLength = 1
            ComSignalType = UINT8
            ComHandleId = 113
            ComSystemTemplateSystemSignalRef = CLU_AutoBrightSta
        ComISignalGroup_MsgGr_FD_P1_CLU_02_100ms: ComHandleId=5, ComSignalGroupArrayAccess=0, ComTimeout=1.5, ComTransferProperty=PENDING, ComSystemTemplateSignalGroupRef=MsgGr_FD_P1_CLU_02_100ms
          FD_P1_CLU_02_100ms_CLU_OdoVal (ComGroupSignal):
            category = TOOL_CONFIGURED
            ComBitPosition = 72
            ComSignalEndianness = LITTLE_ENDIAN
            ComTransferProperty = PENDING
            ComSignalInitValue = 0
            ComBitSize = 24
            ComSignalLength = 3
            ComSignalType = UINT32
            ComHandleId = 30
            ComSystemTemplateSystemSignalRef = CLU_OdoVal
        ComISignalGroup_MsgGr_FD_P1_EMS_01_10ms: ComHandleId=36, ComSignalGroupArrayAccess=0, ComTimeout=0.5, ComTransferProperty=PENDING, ComSystemTemplateSignalGroupRef=MsgGr_FD_P1_EMS_01_10ms
          FD_P1_EMS_01_10ms_ENG_EngRunSta (ComGroupSignal):
            category = TOOL_CONFIGURED
            ComBitPosition = 158
            ComSignalEndianness = LITTLE_ENDIAN
            ComTransferProperty = PENDING
            ComSignalInitValue = 0
            ComBitSize = 2
            ComSignalLength = 1
            ComSignalType = UINT8
            ComHandleId = 128
            ComSystemTemplateSystemSignalRef = ENG_EngRunSta
          FD_P1_EMS_01_10ms_ENG_VehSpdHiVal (ComGroupSignal):
            category = TOOL_CONFIGURED
            ComBitPosition = 224
            ComSignalEndianness = LITTLE_ENDIAN
            ComTransferProperty = PENDING
            ComSignalInitValue = 0
            ComBitSize = 9
            ComSignalLength = 2
            ComSignalType = UINT16
            ComHandleId = 129
            ComSystemTemplateSystemSignalRef = ENG_VehSpdHiVal
        ComISignalGroup_MsgGr_FD_P1_EMS_02_10ms: ComHandleId=14, ComSignalGroupArrayAccess=0, ComTimeout=0.5, ComTransferProperty=PENDING, ComSystemTemplateSignalGroupRef=MsgGr_FD_P1_EMS_02_10ms
          FD_P1_EMS_02_10ms_ENG_EngSta (ComGroupSignal):
            category = TOOL_CONFIGURED
            ComBitPosition = 61
            ComSignalEndianness = LITTLE_ENDIAN
            ComTransferProperty = PENDING
            ComSignalInitValue = 0
            ComBitSize = 3
            ComSignalLength = 1
            ComSignalType = UINT8
            ComHandleId = 54
            ComSystemTemplateSystemSignalRef = ENG_EngSta
        ComISignalGroup_MsgGr_FD_P1_HU_USM_06_00ms: ComHandleId=7, ComSignalGroupArrayAccess=0, ComTransferProperty=TRIGGERED_ON_CHANGE, ComTimeout=0.5, ComSystemTemplateSignalGroupRef=MsgGr_FD_P1_HU_USM_06_00ms
          FD_P1_HU_USM_06_00ms_USM_SBW_RotateModeChangeReq (ComGroupSignal):
            category = TOOL_CONFIGURED
            ComBitPosition = 43
            ComSignalEndianness = LITTLE_ENDIAN
            ComTransferProperty = TRIGGERED_ON_CHANGE
            ComSignalInitValue = 3
            ComBitSize = 2
            ComSignalLength = 1
            ComSignalType = UINT8
            ComHandleId = 38
            ComSystemTemplateSystemSignalRef = USM_SBW_RotateModeChangeReq
        ComISignalGroup_MsgGr_FD_P1_ICC_02_50ms: ComHandleId=20, ComSignalGroupArrayAccess=0, ComTimeout=1.5, ComTransferProperty=PENDING, ComSystemTemplateSignalGroupRef=MsgGr_FD_P1_ICC_02_50ms
          FD_P1_ICC_02_50ms_ICC_FaceDetectStat (ComGroupSignal):
            category = TOOL_CONFIGURED
            ComBitPosition = 96
            ComSignalEndianness = LITTLE_ENDIAN
            ComTransferProperty = PENDING
            ComSignalInitValue = 0
            ComBitSize = 2
            ComSignalLength = 1
            ComSignalType = UINT8
            ComHandleId = 68
            ComSystemTemplateSystemSignalRef = ICC_FaceDetectStat
        ComISignalGroup_MsgGr_FD_P1_IEB_01_10ms: ComHandleId=19, ComSignalGroupArrayAccess=0, ComTimeout=0.5, ComTransferProperty=PENDING, ComSystemTemplateSignalGroupRef=MsgGr_FD_P1_IEB_01_10ms
          FD_P1_IEB_01_10ms_IEB_StrkDpthmmVal (ComGroupSignal):
            category = TOOL_CONFIGURED
            ComBitPosition = 40
            ComSignalEndianness = LITTLE_ENDIAN
            ComTransferProperty = PENDING
            ComSignalInitValue = 0
            ComBitSize = 16
            ComSignalLength = 2
            ComSignalType = SINT16
            ComHandleId = 66
            ComSystemTemplateSystemSignalRef = IEB_StrkDpthmmVal
          FD_P1_IEB_01_10ms_IEB_PdlTrvlSnsrFailSta (ComGroupSignal):
            category = TOOL_CONFIGURED
            ComBitPosition = 58
            ComSignalEndianness = LITTLE_ENDIAN
            ComTransferProperty = PENDING
            ComSignalInitValue = 0
            ComBitSize = 2
            ComSignalLength = 1
            ComSignalType = UINT8
            ComHandleId = 67
            ComSystemTemplateSystemSignalRef = IEB_PdlTrvlSnsrFailSta
        ComISignalGroup_MsgGr_FD_P1_PDC_FD_01_200ms: ComHandleId=17, ComSignalGroupArrayAccess=0, ComTimeout=1.5, ComTransferProperty=TRIGGERED_ON_CHANGE, ComSystemTemplateSignalGroupRef=MsgGr_FD_P1_PDC_FD_01_200ms
          FD_P1_PDC_FD_01_200ms_Warn_DrvStOccSta (ComGroupSignal):
            category = TOOL_CONFIGURED
            ComBitPosition = 103
            ComSignalEndianness = LITTLE_ENDIAN
            ComTransferProperty = TRIGGERED_ON_CHANGE
            ComSignalInitValue = 0
            ComBitSize = 3
            ComSignalLength = 1
            ComSignalType = UINT8
            ComHandleId = 57
            ComSystemTemplateSystemSignalRef = Warn_DrvStOccSta
          FD_P1_PDC_FD_01_200ms_Trunk_TrnkTlgtSwSta (ComGroupSignal):
            category = TOOL_CONFIGURED
            ComBitPosition = 145
            ComSignalEndianness = LITTLE_ENDIAN
            ComTransferProperty = TRIGGERED_ON_CHANGE
            ComSignalInitValue = 0
            ComBitSize = 2
            ComSignalLength = 1
            ComSignalType = UINT8
            ComHandleId = 58
            ComSystemTemplateSystemSignalRef = Trunk_TrnkTlgtSwSta
        ComISignalGroup_MsgGr_FD_P1_PDC_FD_02_200ms: ComHandleId=15, ComSignalGroupArrayAccess=0, ComTimeout=1.5, ComTransferProperty=TRIGGERED_ON_CHANGE, ComSystemTemplateSignalGroupRef=MsgGr_FD_P1_PDC_FD_02_200ms
          FD_P1_PDC_FD_02_200ms_IntLamp_InlTailLmpSta (ComGroupSignal):
            category = TOOL_CONFIGURED
            ComBitPosition = 64
            ComSignalEndianness = LITTLE_ENDIAN
            ComTransferProperty = TRIGGERED_ON_CHANGE
            ComSignalInitValue = 0
            ComBitSize = 2
            ComSignalLength = 1
            ComSignalType = UINT8
            ComHandleId = 55
            ComSystemTemplateSystemSignalRef = IntLamp_InlTailLmpSta
        ComISignalGroup_MsgGr_FD_P1_SBCM_DRV_FD_01_200ms: ComHandleId=16, ComSignalGroupArrayAccess=0, ComTimeout=1.5, ComTransferProperty=TRIGGERED_ON_CHANGE, ComSystemTemplateSignalGroupRef=MsgGr_FD_P1_SBCM_DRV_FD_01_200ms
          FD_P1_SBCM_DRV_FD_01_200ms_Warn_DrvDrSwSta_SBCM (ComGroupSignal):
            category = TOOL_CONFIGURED
            ComBitPosition = 84
            ComSignalEndianness = LITTLE_ENDIAN
            ComTransferProperty = TRIGGERED_ON_CHANGE
            ComSignalInitValue = 0
            ComBitSize = 2
            ComSignalLength = 1
            ComSignalType = UINT8
            ComHandleId = 56
            ComSystemTemplateSystemSignalRef = Warn_DrvDrSwSta_SBCM
        ComISignalGroup_MsgGr_FD_P1_SBCM_RL_FD_01_200ms: ComHandleId=12, ComSignalGroupArrayAccess=0, ComTimeout=1.5, ComTransferProperty=TRIGGERED_ON_CHANGE, ComSystemTemplateSignalGroupRef=MsgGr_FD_P1_SBCM_RL_FD_01_200ms
          FD_P1_SBCM_RL_FD_01_200ms_Warn_RrLftDrSwSta_SBCM (ComGroupSignal):
            category = TOOL_CONFIGURED
            ComBitPosition = 80
            ComSignalEndianness = LITTLE_ENDIAN
            ComTransferProperty = TRIGGERED_ON_CHANGE
            ComSignalInitValue = 0
            ComBitSize = 2
            ComSignalLength = 1
            ComSignalType = UINT8
            ComHandleId = 48
            ComSystemTemplateSystemSignalRef = Warn_RrLftDrSwSta_SBCM
        ComISignalGroup_MsgGr_FD_P1_SBCM_RR_FD_01_200ms: ComHandleId=9, ComSignalGroupArrayAccess=0, ComTimeout=1.5, ComTransferProperty=TRIGGERED_ON_CHANGE, ComSystemTemplateSignalGroupRef=MsgGr_FD_P1_SBCM_RR_FD_01_200ms
          FD_P1_SBCM_RR_FD_01_200ms_Warn_RrRtDrSwSta_SBCM (ComGroupSignal):
            category = TOOL_CONFIGURED
            ComBitPosition = 80
            ComSignalEndianness = LITTLE_ENDIAN
            ComTransferProperty = TRIGGERED_ON_CHANGE
            ComSignalInitValue = 0
            ComBitSize = 2
            ComSignalLength = 1
            ComSignalType = UINT8
            ComHandleId = 40
            ComSystemTemplateSystemSignalRef = Warn_RrRtDrSwSta_SBCM
        ComISignalGroup_MsgGr_FD_P1_SBW_CCP_REQ: ComHandleId=2, ComSignalGroupArrayAccess=0, ComTransferProperty=TRIGGERED, ComTimeout=0.5, ComSystemTemplateSignalGroupRef=MsgGr_FD_P1_SBW_CCP_REQ
          8 x ComGroupSignal, all with category=TOOL_CONFIGURED, ComSignalEndianness=LITTLE_ENDIAN, ComSignalInitValue=0, ComBitSize=8, ComSignalLength=1, ComSignalType=UINT8:
            FD_P1_SBW_CCP_REQ_SBW_CCP_REQ_Byte0: ComBitPosition=0, ComHandleId=13, ComSystemTemplateSystemSignalRef=SBW_CCP_REQ_Byte0
            FD_P1_SBW_CCP_REQ_SBW_CCP_REQ_Byte1: ComBitPosition=8, ComHandleId=14, ComSystemTemplateSystemSignalRef=SBW_CCP_REQ_Byte1
            FD_P1_SBW_CCP_REQ_SBW_CCP_REQ_Byte2: ComBitPosition=16, ComHandleId=15, ComSystemTemplateSystemSignalRef=SBW_CCP_REQ_Byte2
            FD_P1_SBW_CCP_REQ_SBW_CCP_REQ_Byte3: ComBitPosition=24, ComHandleId=16, ComSystemTemplateSystemSignalRef=SBW_CCP_REQ_Byte3
            FD_P1_SBW_CCP_REQ_SBW_CCP_REQ_Byte4: ComBitPosition=32, ComHandleId=17, ComSystemTemplateSystemSignalRef=SBW_CCP_REQ_Byte4
            FD_P1_SBW_CCP_REQ_SBW_CCP_REQ_Byte5: ComBitPosition=40, ComHandleId=18, ComSystemTemplateSystemSignalRef=SBW_CCP_REQ_Byte5
            FD_P1_SBW_CCP_REQ_SBW_CCP_REQ_Byte6: ComBitPosition=48, ComHandleId=19, ComSystemTemplateSystemSignalRef=SBW_CCP_REQ_Byte6
            FD_P1_SBW_CCP_REQ_SBW_CCP_REQ_Byte7: ComBitPosition=56, ComHandleId=20, ComSystemTemplateSystemSignalRef=SBW_CCP_REQ_Byte7
        ComISignalGroup_MsgGr_FD_P1_SBW_CCP_RESP: ComHandleId=0, ComSignalGroupArrayAccess=0, ComTransferProperty=TRIGGERED, ComSystemTemplateSignalGroupRef=MsgGr_FD_P1_SBW_CCP_RESP
          8 x ComGroupSignal, all with category=TOOL_CONFIGURED, ComSignalEndianness=LITTLE_ENDIAN, ComSignalInitValue=0, ComBitSize=8, ComSignalLength=1, ComSignalType=UINT8:
            FD_P1_SBW_CCP_RESP_SBW_CCP_RESP_Byte0: ComBitPosition=0, ComHandleId=1, ComSystemTemplateSystemSignalRef=SBW_CCP_RESP_Byte0
            FD_P1_SBW_CCP_RESP_SBW_CCP_RESP_Byte1: ComBitPosition=8, ComHandleId=2, ComSystemTemplateSystemSignalRef=SBW_CCP_RESP_Byte1
            FD_P1_SBW_CCP_RESP_SBW_CCP_RESP_Byte2: ComBitPosition=16, ComHandleId=3, ComSystemTemplateSystemSignalRef=SBW_CCP_RESP_Byte2
            FD_P1_SBW_CCP_RESP_SBW_CCP_RESP_Byte3: ComBitPosition=24, ComHandleId=4, ComSystemTemplateSystemSignalRef=SBW_CCP_RESP_Byte3
            FD_P1_SBW_CCP_RESP_SBW_CCP_RESP_Byte4: ComBitPosition=32, ComHandleId=5, ComSystemTemplateSystemSignalRef=SBW_CCP_RESP_Byte4
            FD_P1_SBW_CCP_RESP_SBW_CCP_RESP_Byte5: ComBitPosition=40, ComHandleId=6, ComSystemTemplateSystemSignalRef=SBW_CCP_RESP_Byte5
            FD_P1_SBW_CCP_RESP_SBW_CCP_RESP_Byte6: ComBitPosition=48, ComHandleId=7, ComSystemTemplateSystemSignalRef=SBW_CCP_RESP_Byte6
            FD_P1_SBW_CCP_RESP_SBW_CCP_RESP_Byte7: ComBitPosition=56, ComHandleId=8, ComSystemTemplateSystemSignalRef=SBW_CCP_RESP_Byte7
        ComISignalGroup_MsgGr_FD_P1_VCMS_02_100ms: ComHandleId=35, ComSignalGroupArrayAccess=0, ComTimeout=1.5, ComTransferProperty=PENDING, ComSystemTemplateSignalGroupRef=MsgGr_FD_P1_VCMS_02_100ms
          3 x ComGroupSignal, all with category=TOOL_CONFIGURED, ComSignalEndianness=LITTLE_ENDIAN, ComTransferProperty=PENDING, ComSignalInitValue=0, ComBitSize=2, ComSignalLength=1, ComSignalType=UINT8:
            FD_P1_VCMS_02_100ms_VCMS_PDStatus: ComBitPosition=26, ComHandleId=125, ComSystemTemplateSystemSignalRef=VCMS_PDStatus
            FD_P1_VCMS_02_100ms_VCMS_Rdy: ComBitPosition=34, ComHandleId=126, ComSystemTemplateSystemSignalRef=VCMS_Rdy
            FD_P1_VCMS_02_100ms_VCMS_GbtPlugConnect: ComBitPosition=214, ComHandleId=127, ComSystemTemplateSystemSignalRef=VCMS_GbtPlugConnect
        ComISignalGroup_MsgGr_FD_P1_VCU_04_100ms: ComHandleId=8, ComSignalGroupArrayAccess=0, ComTimeout=1.5, ComTransferProperty=PENDING, ComSystemTemplateSignalGroupRef=MsgGr_FD_P1_VCU_04_100ms
          FD_P1_VCU_04_100ms_VCU_UtilModeActSta (ComGroupSignal):
            category = TOOL_CONFIGURED
            ComBitPosition = 226
            ComSignalEndianness = LITTLE_ENDIAN
            ComTransferProperty = PENDING
            ComSignalInitValue = 0
            ComBitSize = 2
            ComSignalLength = 1
            ComSignalType = UINT8
            ComHandleId = 39
            ComSystemTemplateSystemSignalRef = VCU_UtilModeActSta
        ComISignalGroup_MsgGr_FD_P1_WAKEUP_01_00ms: ComHandleId=0, ComSignalGroupArrayAccess=0, ComTransferProperty=TRIGGERED_ON_CHANGE, ComTimeout=0.5, ComSystemTemplateSignalGroupRef=MsgGr_FD_P1_WAKEUP_01_00ms
          5 x ComGroupSignal, all with category=TOOL_CONFIGURED, ComSignalEndianness=LITTLE_ENDIAN, ComTransferProperty=TRIGGERED_ON_CHANGE, ComBitSize=2, ComSignalLength=1, ComSignalType=UINT8:
            FD_P1_WAKEUP_01_00ms_WakeUp_Warn_DrvDrSwSta: ComBitPosition=8, ComSignalInitValue=2, ComHandleId=1, ComSystemTemplateSystemSignalRef=WakeUp_Warn_DrvDrSwSta
            FD_P1_WAKEUP_01_00ms_WakeUp_DoorLock_DrvDrUnLkSta: ComBitPosition=10, ComSignalInitValue=2, ComHandleId=2, ComSystemTemplateSystemSignalRef=WakeUp_DoorLock_DrvDrUnLkSta
            FD_P1_WAKEUP_01_00ms_WakeUp_BCM_Ign1InSta: ComBitPosition=16, ComSignalInitValue=0, ComHandleId=3, ComSystemTemplateSystemSignalRef=WakeUp_BCM_Ign1InSta
            FD_P1_WAKEUP_01_00ms_WakeUp_Warn_AsstDrSwSta: ComBitPosition=30, ComSignalInitValue=2, ComHandleId=4, ComSystemTemplateSystemSignalRef=WakeUp_Warn_AsstDrSwSta
            FD_P1_WAKEUP_01_00ms_WakeUp_BCM_Lamp_IntTailLmpOnReq: ComBitPosition=47, ComSignalInitValue=0, ComHandleId=5, ComSystemTemplateSystemSignalRef=WakeUp_BCM_Lamp_IntTailLmpOnReq
        ComISignalGroup_MsgGr_FD_P1_WHL_01_10ms: ComHandleId=24, ComSignalGroupArrayAccess=0, ComTimeout=0.5, ComTransferProperty=PENDING, ComSystemTemplateSignalGroupRef=MsgGr_FD_P1_WHL_01_10ms
          FD_P1_WHL_01_10ms_WHL_SpdFLVal (ComGroupSignal):
            category = TOOL_CONFIGURED
            ComBitPosition = 64
            ComSignalEndianness = LITTLE_ENDIAN
            ComTransferProperty = PENDING
            ComSignalInitValue = 0
            ComBitSize = 14
            ComSignalLength = 2
            ComSignalType = UINT16
            ComHandleId = 77
            ComSystemTemplateSystemSignalRef = WHL_SpdFLVal
      3 x ComIPdu, all with category=TOOL_CONFIGURED, ComIPduDirection=RECEIVE, ComIPduType=NORMAL, ComIPduSignalProcessing=DEFERRED, ComIPduGroupRef=ComIPduGroupRx_SBW_FD_P1_PNC32_PNC73_DiagComControl:
        ComIPdu_FD_P1_VPC_01_10ms: ComIPduHandleId=38, ComIPduSignalGroupRef=ComISignalGroup_MsgGr_FD_P1_VPC_01_10ms, ComPduIdRef=Pdu_ISignalIPdu_FD_P1_VPC_01_10ms
        ComIPdu_FD_P1_CCU_OTA_01_200ms: ComIPduHandleId=39, ComIPduSignalGroupRef=ComISignalGroup_MsgGr_FD_P1_CCU_OTA_01_200ms, ComPduIdRef=Pdu_ISignalIPdu_FD_P1_CCU_OTA_01_200ms
        ComIPdu_FD_P1_SCM_FD_01_200ms: ComIPduHandleId=40, ComIPduSignalGroupRef=ComISignalGroup_MsgGr_FD_P1_SCM_FD_01_200ms, ComPduIdRef=Pdu_ISignalIPdu_FD_P1_SCM_FD_01_200ms
      4 x ComSignalGroup, all with category=TOOL_CONFIGURED:
        ComISignalGroup_MsgGr_E2E_FD_P1_HCU_03_10ms: ComHandleId=32, ComSignalGroupArrayAccess=1, ComTimeout=0.5, ComTransferProperty=PENDING, ComSystemTemplateSignalGroupRef=MsgGr_FD_P1_HCU_03_10ms
          4 x ComGroupSignal, all with category=TOOL_CONFIGURED, ComSignalEndianness=LITTLE_ENDIAN:
            FD_P1_HCU_03_10ms_HCU_Crc3Val: ComBitPosition=0, ComTransferProperty=PENDING, ComSignalInitValue=65535, ComBitSize=16, ComSignalLength=2, ComSignalType=UINT16, ComHandleId=115, ComSystemTemplateSystemSignalRef=HCU_Crc3Val
            FD_P1_HCU_03_10ms_HCU_AlvCnt3Val: ComBitPosition=16, ComTransferProperty=PENDING, ComSignalInitValue=0, ComBitSize=8, ComSignalLength=1, ComSignalType=UINT8, ComHandleId=116, ComSystemTemplateSystemSignalRef=HCU_AlvCnt3Val
            FD_P1_HCU_03_10ms_HCU_HevRdySta: ComBitPosition=70, ComTransferProperty=PENDING, ComSignalInitValue=0, ComBitSize=2, ComSignalLength=1, ComSignalType=UINT8, ComHandleId=117, ComSystemTemplateSystemSignalRef=HCU_HevRdySta
            FD_P1_HCU_03_10ms_HCU_03_10ms_E2EReserved: ComBitPosition=255, ComSignalInitValue=0, ComBitSize=1, ComSignalLength=1, ComSignalType=BOOLEAN, ComHandleId=118, ComSystemTemplateSystemSignalRef=HCU_03_10ms_E2EReserved
        ComISignalGroup_MsgGr_FD_P1_CCU_OTA_01_200ms: ComHandleId=39, ComSignalGroupArrayAccess=0, ComTimeout=1.5, ComTransferProperty=TRIGGERED_ON_CHANGE, ComSystemTemplateSignalGroupRef=MsgGr_FD_P1_CCU_OTA_01_200ms
          FD_P1_CCU_OTA_01_200ms_CCU_OTA_mode (ComGroupSignal):
            category = TOOL_CONFIGURED
            ComBitPosition = 28
            ComSignalEndianness = LITTLE_ENDIAN
            ComTransferProperty = TRIGGERED_ON_CHANGE
            ComSignalInitValue = 0
            ComBitSize = 4
            ComSignalLength = 1
            ComSignalType = UINT8
            ComHandleId = 136
            ComSystemTemplateSystemSignalRef = CCU_OTA_mode
        ComISignalGroup_MsgGr_FD_P1_SCM_FD_01_200ms: ComHandleId=40, ComSignalGroupArrayAccess=0, ComTimeout=1.5, ComTransferProperty=TRIGGERED_ON_CHANGE, ComSystemTemplateSignalGroupRef=MsgGr_FD_P1_SCM_FD_01_200ms
          FD_P1_SCM_FD_01_200ms_Tele_PositionState (ComGroupSignal):
            category = TOOL_CONFIGURED
            ComBitPosition = 30
            ComSignalEndianness = LITTLE_ENDIAN
            ComTransferProperty = TRIGGERED_ON_CHANGE
            ComSignalInitValue = 0
            ComBitSize = 2
            ComSignalLength = 1
            ComSignalType = UINT8
            ComHandleId = 137
            ComSystemTemplateSystemSignalRef = Tele_PositionState
        ComISignalGroup_MsgGr_FD_P1_VPC_01_10ms: ComHandleId=38, ComSignalGroupArrayAccess=0, ComTimeout=1.5, ComTransferProperty=PENDING, ComSystemTemplateSignalGroupRef=MsgGr_FD_P1_VPC_01_10ms
          FD_P1_VPC_01_10ms_VPC_SafetyModeSta (ComGroupSignal):
            category = TOOL_CONFIGURED
            ComBitPosition = 36
            ComSignalEndianness = LITTLE_ENDIAN
            ComTransferProperty = PENDING
            ComSignalInitValue = 0
            ComBitSize = 2
            ComSignalLength = 1
            ComSignalType = UINT8
            ComHandleId = 135
            ComSystemTemplateSystemSignalRef = VPC_SafetyModeSta
      ComIPdu_Rx_EIRA_CanNm (ComIPdu):
        category = TOOL_CONFIGURED
        ComIPduDirection = RECEIVE
        ComIPduHandleId = 42
        ComIPduSignalProcessing = DEFERRED
        ComIPduType = NORMAL
        ComIPduSignalRef = ComISignal_Rx_EIRA_CanNm
        ComPduIdRef = Pdu_ComMPdu_Rx_EIRA_CanNm
      ComIPdu_Tx_PncVector_FD_P1 (ComIPdu):
        category = TOOL_CONFIGURED
        ComIPduDirection = SEND
        ComIPduHandleId = 3
        ComIPduSignalProcessing = DEFERRED
        ComIPduType = NORMAL
        ComIPduSignalRef = ComISignal_Tx_PncVector_FD_P1
        ComPduIdRef = Pdu_ComMPdu_Tx_PncVector_FD_P1
        ComTxIpdu_ComIPdu_Tx_PncVector_FD_P1 (ComTxIPdu): category=TOOL_CONFIGURED, ComTxIPduUnusedAreasDefault=0, ComMinimumDelayTime=0.02
          ComTxModeTrue_ComTxIpdu_ComIPdu_Tx_PncVector_FD_P1 (ComTxModeTrue): category=TOOL_CONFIGURED
            ComTxMode_ComTxModeTrue_ComTxIpdu_ComIPdu_Tx_PncVector_FD_P1 (ComTxMode): category=TOOL_CONFIGURED, ComTxModeMode=NONE
      ComISignal_Rx_EIRA_CanNm (ComSignal):
        category = TOOL_CONFIGURED
        ComBitPosition = 0
        ComHandleId = 0
        ComSignalEndianness = opaque
        ComSignalInitValue = 0
        ComSignalLength = 28
        ComSignalType = UINT8_N
        ComTransferProperty = PENDING
        ComNotification = ComM_COMCbk_ComISignal_Rx_EIRA_CanNm
        ComSystemTemplateSystemSignalRef = PNI_ALDC_3
      ComISignal_Tx_PncVector_FD_P1 (ComSignal):
        category = TOOL_CONFIGURED
        ComBitPosition = 0
        ComHandleId = 0
        ComSignalEndianness = opaque
        ComSignalInitValue = 0
        ComSignalLength = 28
        ComSignalType = UINT8_N
        ComTransferProperty = PENDING
        ComSystemTemplateSystemSignalRef = PNI_SBW_3
      4 x ComIPduGroup, all with category=TOOL_CONFIGURED:
        ComIPduGroupTx_SBW_FD_P1_PNC32_PNC73_DiagComControl: ComIPduGroupHandleId=2
        ComIPduGroupTx_SBW_FD_P1_PNC32_PNC73_NoDiagComControl: ComIPduGroupHandleId=3
        ComIPduGroupRx_SBW_FD_P1_PNC32_PNC73_NoDiagComControl: ComIPduGroupHandleId=4
        ComIPduGroupRx_SBW_FD_P1_PNC32_PNC73_DiagComControl: ComIPduGroupHandleId=5
      ComIPdu_FD_P2_L_HCU_03_10ms_back (ComIPdu):
        category = TOOL_CONFIGURED
        ComIPduDirection = RECEIVE
        ComIPduHandleId = 41
        ComIPduType = NORMAL
        ComIPduSignalProcessing = DEFERRED
        ComIPduGroupRef = ComIPduGroupRx_SBW_FD_P2
        ComIPduSignalGroupRef = ComISignalGroup_MsgGr_E2E_FD_P2_L_HCU_03_10ms_back
        ComPduIdRef = Pdu_ISignalIPdu_FD_P2_L_HCU_03_10ms_back
      ComISignalGroup_MsgGr_E2E_FD_P2_L_HCU_03_10ms_back (ComSignalGroup):
        category = TOOL_CONFIGURED
        ComHandleId = 41
        ComSignalGroupArrayAccess = 1
        ComTimeout = 0.5
        ComTransferProperty = PENDING
        ComSystemTemplateSignalGroupRef = MsgGr_FD_P2_L_HCU_03_10ms_back
        4 x ComGroupSignal, all with category=TOOL_CONFIGURED, ComSignalEndianness=LITTLE_ENDIAN:
          FD_P2_L_HCU_03_10ms_back_LHCU_Crc3Val: ComBitPosition=0, ComTransferProperty=PENDING, ComSignalInitValue=65535, ComBitSize=16, ComSignalLength=2, ComSignalType=UINT16, ComHandleId=138, ComSystemTemplateSystemSignalRef=LHCU_Crc3Val
          FD_P2_L_HCU_03_10ms_back_LHCU_AlvCnt3Val: ComBitPosition=16, ComTransferProperty=PENDING, ComSignalInitValue=0, ComBitSize=8, ComSignalLength=1, ComSignalType=UINT8, ComHandleId=139, ComSystemTemplateSystemSignalRef=LHCU_AlvCnt3Val
          FD_P2_L_HCU_03_10ms_back_LHCU_HevRdyFsSta: ComBitPosition=92, ComTransferProperty=PENDING, ComSignalInitValue=0, ComBitSize=2, ComSignalLength=1, ComSignalType=UINT8, ComHandleId=140, ComSystemTemplateSystemSignalRef=LHCU_HevRdyFsSta
          FD_P2_L_HCU_03_10ms_back_L_HCU_03_10ms_back_E2EReserved: ComBitPosition=255, ComSignalInitValue=0, ComBitSize=1, ComSignalLength=1, ComSignalType=BOOLEAN, ComHandleId=141, ComSystemTemplateSystemSignalRef=L_HCU_03_10ms_back_E2EReserved
    ComGeneral:
      ComSupportedIPduGroups = 6
      ComEnableMDTForCyclicTransmission = 1
      ComMainFunctionBasedTransmit = 1
      ComEnableSignalGroupArrayApi = 1
      ComVersionInfoApi = 0
      ComIpduReadApiSupport = 0
      ComBufferInitiateOnPduStartTime = 0
      ComMetaDataSupport = 0
