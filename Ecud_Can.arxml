AUTOSAR XML (schema 4-0-3)
package /Can_43_FLEXCAN
  module config Can: implementation-config-variant=VARIANT-POST-BUILD, module-description=BswImplementation_Can
    CanConfigSet
      SGU_FD_B2 (CanController):
        category = TOOL_CONFIGURED
        CanControllerId = 0
        CanControllerActivation = 1
        CanWakeupFunctionalityAPI = 0
        CanBusoffProcessing = INTERRUPT
        CanWakeupSupport = 0
        CanControllerBaseAddress = 1076903936
        CanTxProcessing = INTERRUPT
        CanRxProcessing = INTERRUPT
        CanClockFromBus = 1
        CanWakeupProcessing = POLLING
        CanControllerPrExcEn = 0
        CanControllerFdISO = 1
        CanLoopBackMode = 0
        CanHwChannel = FLEXCAN_0
        CanTrippleSamplingEnable = 0
        CanControllerEdgeFilter = 0
        CanAutoBusOffRecovery = 0
        CanCpuClockRef = McuClockReferencePoint_FXOSC_CLK
        CanControllerDefaultBaudrate = CanControllerBaudrateConfig
        CanControllerBaudrateConfig:
          category = TOOL_CONFIGURED
          CanControllerBaudRateConfigID = 0
          CanControllerSyncJumpWidth = 1
          CanControllerPrescaller = 5
          CanControllerPrescallerAlternate = 1
          CanControllerBaudRate = 500
          CanBaudrateTypeSuport = NORMAL_CBT
          CanControllerSeg2 = 3
          CanBusLength = 40
          CanControllerSeg1 = 8
          CanTxArbitrationStartDelay = 12
          CanControllerSyncSeg = 1
          CanControllerPropSeg = 4
          CanPropDelayTranceiver = 150.0
          CanAdvancedSetting = 0
      14 x CanHardwareObject, all with category=TOOL_CONFIGURED, CanHwObjectCount=1, CanControllerRef=SGU_FD_B2:
        IN_HwObj_SGU_FD_B2_0x35_FD_B2_VCU_01_10ms: CanObjectType=RECEIVE, CanHandleType=FULL, CanIdType=STANDARD, CanObjectId=0
          CanHwFilter0 (CanHwFilter): category=TOOL_CONFIGURED, CanHwFilterMask=2047, CanHwFilterCode=53
        IN_HwObj_SGU_FD_B2_0x10_FD_B2_ACU_02_00ms: CanObjectType=RECEIVE, CanHandleType=FULL, CanIdType=STANDARD, CanObjectId=1
          CanHwFilter0 (CanHwFilter): category=TOOL_CONFIGURED, CanHwFilterMask=2047, CanHwFilterCode=16
        IN_HwObj_SGU_FD_B2_0x7df_FD_B2_GST_ALL: CanObjectType=RECEIVE, CanHandleType=FULL, CanIdType=STANDARD, CanObjectId=2
          CanHwFilter0 (CanHwFilter): category=TOOL_CONFIGURED, CanHwFilterMask=2047, CanHwFilterCode=2015
        IN_HwObj_0x80_0xfb_SGU_FD_B2: CanObjectType=RECEIVE, CanHandleType=BASIC, CanIdType=STANDARD, CanObjectId=3
          CanHwFilter0 (CanHwFilter): category=TOOL_CONFIGURED, CanHwFilterMask=1924, CanHwFilterCode=128
        IN_HwObj_0x100_0x1b7_SGU_FD_B2: CanObjectType=RECEIVE, CanHandleType=BASIC, CanIdType=STANDARD, CanObjectId=4
          CanHwFilter0 (CanHwFilter): category=TOOL_CONFIGURED, CanHwFilterMask=1864, CanHwFilterCode=256
        IN_HwObj_0x2a0_0x2ff_SGU_FD_B2: CanObjectType=RECEIVE, CanHandleType=BASIC, CanIdType=STANDARD, CanObjectId=5
          CanHwFilter0 (CanHwFilter): category=TOOL_CONFIGURED, CanHwFilterMask=1952, CanHwFilterCode=672
        IN_HwObj_0x340_0x3f7_SGU_FD_B2: CanObjectType=RECEIVE, CanHandleType=BASIC, CanIdType=STANDARD, CanObjectId=6
          CanHwFilter0 (CanHwFilter): category=TOOL_CONFIGURED, CanHwFilterMask=1864, CanHwFilterCode=832
        IN_HwObj_0x400_0x4c2_SGU_FD_B2: CanObjectType=RECEIVE, CanHandleType=BASIC, CanIdType=STANDARD, CanObjectId=7
          CanHwFilter0 (CanHwFilter): category=TOOL_CONFIGURED, CanHwFilterMask=1853, CanHwFilterCode=1024
        IN_HwObj_0x500_0x5e7_SGU_FD_B2: CanObjectType=RECEIVE, CanHandleType=BASIC, CanIdType=STANDARD, CanObjectId=8
          CanHwFilter0 (CanHwFilter): category=TOOL_CONFIGURED, CanHwFilterMask=1816, CanHwFilterCode=1280
        IN_HwObj_0x17fc0000_0x17fc00fe_SGU_FD_B2_NM_Message: CanObjectType=RECEIVE, CanHandleType=BASIC, CanIdType=EXTENDED, CanObjectId=9
          CanHwFilter0 (CanHwFilter): category=TOOL_CONFIGURED, CanHwFilterMask=536870656, CanHwFilterCode=402391040
        OUT_HwObj_SGU_FD_B2_0x17fc00be_FD_B2_NM_SGU_FD: CanObjectType=TRANSMIT, CanHandleType=FULL, CanIdType=EXTENDED, CanObjectId=10
        OUT_HwObj_SGU_FD_B2_0x58c_FD_B2_SGU_GST: CanObjectType=TRANSMIT, CanHandleType=FULL, CanIdType=STANDARD, CanObjectId=11
        OUT_HwObj_SGU_FD_B2_0x388_FD_B2_SGU_FD_01_500ms: CanObjectType=TRANSMIT, CanHandleType=FULL, CanIdType=STANDARD, CanObjectId=12
        OUT_HwObj_SGU_FD_B2_0x333_FD_B2_SGU_FD_02_500ms: CanObjectType=TRANSMIT, CanHandleType=FULL, CanIdType=STANDARD, CanObjectId=13
    CanGeneral:
      CanDevErrorDetect = 1
      CanEnableDualClockMode = 0
      CanEnableUserModeSupport = 0
      CanGlobalTimeSupport = 0
      CanIndex = 0
      CanMBCountExtensionSupport = 1
      CanMainFunctionModePeriod = 0.005
      CanMulticoreSupport = 0
      CanMultiplexedTransmission = 1
      CanPublicIcomSupport = 0
      CanTimeoutDuration = 1.0
      CanTimeoutMethod = OSIF_COUNTER_DUMMY
      CanVersionInfoApi = 0
      CanEnableSecurityEventReporting = 0
    CommonPublishedInformation:
      ArReleaseMajorVersion = 4
      ArReleaseMinorVersion = 4
      ArReleaseRevisionVersion = 0
      ModuleId = 80
      SwMajorVersion = 3
      SwMinorVersion = 0
      SwPatchVersion = 0
      VendorId = 43
      VendorApiInfix = FLEXCAN
