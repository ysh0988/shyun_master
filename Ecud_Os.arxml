AUTOSAR XML (schema 4-0-3)
package /AUTOSAR
  module config Os: implementation-config-variant=VARIANT-PRE-COMPILE, module-description=BswImplementation_Os
    11 x OsAlarm, all with OsAlarmCounterRef=OsCounter_Main:
      OsAlarm_BSW_5ms_Com
        OsAlarmAction: category=TOOL_CONFIGURED
          OsAlarmActivateTask: category=TOOL_CONFIGURED, OsAlarmActivateTaskRef=OsTask_BSW_FG1_5ms_Com
      OsAlarm_BSW_10ms
        OsAlarmAction: category=TOOL_CONFIGURED
          OsAlarmActivateTask: category=TOOL_CONFIGURED, OsAlarmActivateTaskRef=OsTask_BSW_FG1_10ms
      OsAlarm_ASW_10ms_PRE
        OsAlarmAction
          OsAlarmActivateTask: OsAlarmActivateTaskRef=OsTask_ASW_FG1_10ms_PRE
      OsAlarm_ASW_10ms
        OsAlarmAction: category=TOOL_CONFIGURED
          OsAlarmActivateTask: category=TOOL_CONFIGURED, OsAlarmActivateTaskRef=OsTask_ASW_FG1_10ms
      OsAlarm_ASW_10ms_POST
        OsAlarmAction
          OsAlarmActivateTask: OsAlarmActivateTaskRef=OsTask_ASW_FG1_10ms_POST
      OsAlarm_ASW_100ms
        OsAlarmAction: category=TOOL_CONFIGURED
          OsAlarmActivateTask: category=TOOL_CONFIGURED, OsAlarmActivateTaskRef=OsTask_ASW_FG1_100ms
      OsAlarm_BSW_Mem_Process
        OsAlarmAction
          OsAlarmSetEvent: OsAlarmSetEventRef=OsEvent_BSW_Mem_Process, OsAlarmSetEventTaskRef=OsTask_BSW_Mem_Process
      OsAlarm_BSW_BG_KeyM_Main
        OsAlarmAction
          OsAlarmSetEvent: OsAlarmSetEventRef=OsEvent_BSW_KeyM_Main, OsAlarmSetEventTaskRef=OsTask_BSW_BG_KeyM_Main
      OsAlarm_BSW_BG_Crypto_Main
        OsAlarmAction
          OsAlarmSetEvent: OsAlarmSetEventRef=OsEvent_BSW_Crypto_Main, OsAlarmSetEventTaskRef=OsTask_BSW_BG_Crypto_Main
      OsAlarm_BSW_BG_Fota_Main
        OsAlarmAction
          OsAlarmSetEvent: OsAlarmSetEventRef=OsEvent_BSW_Fota_Main, OsAlarmSetEventTaskRef=OsTask_BSW_BG_Fota_Main
      OsAlarm_BSW_100ms
        OsAlarmAction
          OsAlarmActivateTask: OsAlarmActivateTaskRef=OsTask_BSW_FG1_100ms
    OsAppMode0 (OsAppMode)
    OsApplication_Main (OsApplication):
      OsApplicationCoreAssignment = 0
      OsTrusted = 1
      OsApplicationStackSize = 8192
      OsTrustedApplicationWithProtection = 0
      OsTrustedApplicationDelayTimingViolationCall = 0
      OsAppAlarmRef = OsAlarm_BSW_5ms_Com
      OsAppAlarmRef = OsAlarm_BSW_10ms
      OsAppAlarmRef = OsAlarm_ASW_10ms
      OsAppCounterRef = OsCounter_Main
      OsAppTaskRef = OsTask_ASW_FG1_10ms
      OsAppTaskRef = OsTask_ASW_FG1_100ms
      OsAppTaskRef = OsTask_BSW_FG1_10ms
      OsAppTaskRef = OsTask_BSW_FG1_5ms_Com
      OsAppTaskRef = OsTask_BSW_FG3_ComMModeRequest
      OsAppTaskRef = OsTask_BSW_Init
      OsAppTaskRef = OsTask_BSW_Mem_Process
      OsAppTaskRef = OsTask_BSW_BG_KeyM_Main
      OsAppTaskRef = OsTask_BSW_FG3_BswM_Action_Main
      OsAppAlarmRef = OsAlarm_ASW_100ms
      OsAppAlarmRef = OsAlarm_BSW_Mem_Process
      OsAppTaskRef = OsTask_BSW_BG_Crypto_Main
      OsAppTaskRef = OsTask_BSW_BG_Fota_Main
      OsAppTaskRef = OsTask_BSW_HSM_Init
      OsAppAlarmRef = OsAlarm_BSW_BG_KeyM_Main
      OsAppAlarmRef = OsAlarm_BSW_BG_Crypto_Main
      OsAppIsrRef = Can_Interrupt_CANFD12_Cat2
      OsAppIsrRef = Icu_Isr_Vector_24_Cat2
      OsAppIsrRef = Icu_Isr_Vector_317_Cat2
      OsAppIsrRef = Hsm_Isr_Vector_4_Cat2
      OsAppIsrRef = Adc_IsrConversionDone_121_Cat2
      OsAppIsrRef = GPT_Isr_Vector_303_Cat2
      OsApplicationCoreRef = EcucCoreDefinition0
      OsAppTaskRef = OsTask_BSW_FG1_100ms
      OsAppAlarmRef = OsAlarm_BSW_BG_Fota_Main
      OsAppIsrRef = Os_TimeFrameIsr
      OsAppAlarmRef = OsAlarm_BSW_100ms
      OsAppEcucPartitionRef = EcucPartition_Main
      OsAppIsrRef = Os_TimingBudgetIsr
      OsAppIsrRef = GPT_Isr_Vector_342_Cat2
      OsAppTaskRef = OsTask_ASW_FG1_10ms_POST
      OsAppTaskRef = OsTask_ASW_FG1_10ms_PRE
      OsAppAlarmRef = OsAlarm_ASW_10ms_POST
      OsAppAlarmRef = OsAlarm_ASW_10ms_PRE
      OsAppTaskRef = OsTask_CAN_DREE_Process
      OsApplicationHooks0 (OsApplicationHooks): OsAppErrorHook=0, OsAppShutdownHook=0, OsAppStartupHook=0
    OsApplication_NonTrusted (OsApplication):
      OsTrusted = 0
      OsApplicationStackSize = 8192
      OsTrustedApplicationWithProtection = 0
      OsTrustedApplicationDelayTimingViolationCall = 0
      OsApplicationCoreAssignment = 0
      OsAppEcucPartitionRef = EcucPartition_NonTrusted
      OsApplicationCoreRef = EcucCoreDefinition0
      OsApplicationHooks: OsAppErrorHook=0, OsAppShutdownHook=0, OsAppStartupHook=0
    OsCounter_Main (OsCounter):
      OsCounterMaxAllowedValue = 0xFFFFFFFF
      OsCounterMinCycle = 1
      OsCounterTicksPerBase = 1
      OsCounterType = HARDWARE
      OsDrivingInterrupt = SYSTICK(0xE000ED20)
      OsSecondsPerTick = 0.001
    14 x OsEvent:
      OsEvent_BSW_Mem_Process: OsEventMask=1
      OsEvent_BSW_KeyM_Main: OsEventMask=0x4000
      OsEvent_BSW_Crypto_Main: OsEventMask=0x8000
      OsEvent_Bsw_BswM_Action_Main: OsEventMask=0x10000
      OsEvent_ASW_FlashDrv_Flash_Erase: OsEventMask=0x2
      OsEvent_ASW_FlashDrv_Flash_Write: OsEventMask=0x4
      OsEvent_Dummy: OsEventMask=0x100000
      OsEvent_BSW_Fota_Main: OsEventMask=0x2000
      OsEvent_BSW_Xcp_EvMain: OsEventMask=0x2000
      OsEvent_CAN_DREE_0: OsEventMask=0x1
      OsEvent_CAN_DREE_1: OsEventMask=0x2
      OsEvent_CAN_DREE_2: OsEventMask=0x4
      OsEvent_CAN_DREE_3: OsEventMask=0x8
      OsEvent_CAN_DREE_4: OsEventMask=0x10
    9 x OsIsr:
      Can_Interrupt_CANFD12_Cat2: OsIsrCategory=CATEGORY_2, OsIsrHardwarePriority=6, OsIsrName=CAN1, Interrupt #0, Channel #2(67), OsIsrStackSize=0x400
      Icu_Isr_Vector_24_Cat2: OsIsrCategory=CATEGORY_2, OsIsrHardwarePriority=6, OsIsrStackSize=0x400, OsIsrName=GPIO_STD Port #3 Interrupt(24)
      Icu_Isr_Vector_317_Cat2: OsIsrCategory=CATEGORY_2, OsIsrHardwarePriority=6, OsIsrName=TCPWM0 Group #0, Counter #17 Interrupt(317), OsIsrStackSize=0x400
      GPT_Isr_Vector_303_Cat2: OsIsrCategory=CATEGORY_2, OsIsrHardwarePriority=6, OsIsrStackSize=1024, OsIsrName=TCPWM0 Group #0, Counter #3 Interrupt(303)
        OsIsrTimingProtection: OsIsrAllInterruptLockBudget=0.001, OsIsrExecutionBudget=0.001, OsIsrOsInterruptLockBudget=0.001, OsIsrTimeFrame=0.001
      Hsm_Isr_Vector_4_Cat2: OsIsrCategory=CATEGORY_2, OsIsrHardwarePriority=6, OsIsrStackSize=1024, OsIsrName=CPUSS Inter Process Communication Interrupt #4(4)
      Adc_IsrConversionDone_121_Cat2: OsIsrCategory=CATEGORY_2, OsIsrHardwarePriority=6, OsIsrStackSize=1024, OsIsrName=SAR1, Channel #1 Interrupt(121)
      Os_TimeFrameIsr: OsIsrCategory=CATEGORY_1, OsIsrHardwarePriority=0, OsIsrStackSize=1024, OsIsrName=TCPWM0 Group #2, Counter #2 Interrupt(377)
      Os_TimingBudgetIsr: OsIsrCategory=CATEGORY_1, OsIsrHardwarePriority=0, OsIsrStackSize=1024, OsIsrName=TCPWM0 Group #2, Counter #1 Interrupt(376)
      GPT_Isr_Vector_342_Cat2: OsIsrCategory=CATEGORY_2, OsIsrHardwarePriority=6, OsIsrStackSize=800, OsIsrName=TCPWM0 Group #0, Counter #42 Interrupt(342)
    OsOs (OsOS):
      OsNumberOfCores = 1
      OsScalabilityClass = SC4
      OsStackMonitoring = 1
      OsStatus = EXTENDED
      OsUseGetServiceId = 1
      OsUseResScheduler = 1
      OsProcessorSeries = CYT2BL
      OsUseParameterAccess = 1
      OsUserStackSize = 8192
      OsStackFrame = StackFrame32
      OsSystemTimerClock = 160
      OsFpuSupport = 1
      OsFullReadAccess = 1
      OsProcessor = CYT2BL
      OsTPSTimerClock = 80
      OsDebug: ORTI=1
      OsHooks0 (OsHooks): OsErrorHook=1, OsProtectionHook=1, OsStartupHook=1, OsShutdownHook=1, OsProfilingHook=1, OsPostTaskHook=1, OsPreTaskHook=1
      5 x OsMpuRegion, all with OsMpuRegionSubregionDisable=0:
        BACKGROUND: OsMpuRegionNumber=0, OsMpuRegionEnabledOnStart=1, OsMpuRegionBaseAddress=0x0, OsMpuRegionSize=Size4GB, OsMpuRegionRwPermission=RW_NONE, OsMpuRegionExecutionPermission=1, OsMpuRegionAttribute=Normal_WT_NoWA_NonShareable
        LIB_CODE: OsMpuRegionNumber=1, OsMpuRegionEnabledOnStart=1, OsMpuRegionBaseAddress=0x100A8000, OsMpuRegionSize=Size8KB, OsMpuRegionRwPermission=RO_RO, OsMpuRegionExecutionPermission=1, OsMpuRegionAttribute=Normal_WT_NoWA_NonShareable
        APP1_CODE: OsMpuRegionNumber=2, OsMpuRegionEnabledOnStart=0, OsMpuRegionBaseAddress=0x100A9000, OsMpuRegionSize=Size4KB, OsMpuRegionRwPermission=RO_RO, OsMpuRegionExecutionPermission=1, OsMpuRegionAttribute=Normal_WB_NoWA_NonShareable, OsMpuRegionLinkerSection=".text.EcucPartition_NonTrusted_CODE", OsMpuRegionAccessingApplication=OsApplication_NonTrusted
        APP1_CONST: OsMpuRegionNumber=3, OsMpuRegionEnabledOnStart=0, OsMpuRegionBaseAddress=0x100AA000, OsMpuRegionSize=Size4KB, OsMpuRegionRwPermission=RO_RO, OsMpuRegionExecutionPermission=0, OsMpuRegionAttribute=Normal_WB_NoWA_NonShareable, OsMpuRegionLinkerSection=".rodata.EcucPartition_NonTrusted_ROM_CONST", OsMpuRegionAccessingApplication=OsApplication_NonTrusted
        APP1_VAR: OsMpuRegionNumber=4, OsMpuRegionEnabledOnStart=0, OsMpuRegionBaseAddress=0x8040000, OsMpuRegionSize=Size4KB, OsMpuRegionRwPermission=RW_RW, OsMpuRegionExecutionPermission=0, OsMpuRegionAttribute=Normal_WB_NoWA_Shareable, OsMpuRegionLinkerSection=".data.EcucPartition_NonTrusted_RAM_VAR_INIT*" ".bss.EcucPartition_NonTrusted_RAM_VAR_CLEARED*", OsMpuRegionAccessingApplication=OsApplication_NonTrusted
    5 x OsResource:
      OsResource_FG1: OsResourceProperty=INTERNAL
      OsResource_FG2: OsResourceProperty=INTERNAL
      OsResource_BG: OsResourceProperty=INTERNAL
      OsResource_Dummy: OsResourceProperty=STANDARD
      XcpResource0: OsResourceProperty=STANDARD
    OsSpinlock_BswM (OsSpinlock): OsSpinlockLockMethod=LOCK_NOTHING, OsSpinlockAccessingApplication=OsApplication_Main, OsSpinlockAccessingApplication=OsApplication_NonTrusted
    16 x OsTask, all with OsTaskActivation=1, OsTaskSchedule=FULL:
      OsTask_BSW_FG3_ComMModeRequest: OsTaskPriority=254, OsTaskStackSize=8192
      OsTask_BSW_FG3_BswM_Action_Main: OsTaskPriority=253, OsTaskStackSize=8192, OsTaskEventRef=OsEvent_Bsw_BswM_Action_Main
        OsTaskAutostart: OsTaskAppModeRef=OsAppMode0
      OsTask_BSW_FG1_5ms_Com: OsTaskPriority=197, OsTaskStackSize=8192, OsTaskResourceRef=OsResource_FG1, OsTaskResourceRef=XcpResource0
      OsTask_BSW_FG1_10ms: OsTaskPriority=180, OsTaskStackSize=8192, OsTaskResourceRef=OsResource_FG1
      OsTask_ASW_FG1_10ms_PRE: OsTaskPriority=141, OsTaskStackSize=4096, OsTaskResourceRef=OsResource_FG1
      OsTask_ASW_FG1_10ms: OsTaskPriority=140, OsTaskStackSize=4096, OsTaskResourceRef=OsResource_FG1
      OsTask_ASW_FG1_10ms_POST: OsTaskPriority=139, OsTaskStackSize=4096, OsTaskResourceRef=OsResource_FG1
      OsTask_ASW_FG1_100ms: OsTaskPriority=116, OsTaskStackSize=8192, OsTaskResourceRef=OsResource_FG1
        OsTaskTimingProtection: OsTaskAllInterruptLockBudget=0.01, OsTaskExecutionBudget=0.01, OsTaskOsInterruptLockBudget=0.01, OsTaskTimeFrame=0.001
      OsTask_BSW_Init: OsTaskPriority=99, OsTaskStackSize=8192
        OsTaskAutostart: OsTaskAppModeRef=OsAppMode0
      OsTask_BSW_Mem_Process: OsTaskPriority=90, OsTaskStackSize=8192, OsTaskEventRef=OsEvent_BSW_Mem_Process
      OsTask_BSW_BG_KeyM_Main: OsTaskPriority=20, OsTaskStackSize=8192, OsTaskEventRef=OsEvent_BSW_KeyM_Main, OsTaskResourceRef=OsResource_BG
      OsTask_BSW_BG_Crypto_Main: OsTaskPriority=20, OsTaskStackSize=8192, OsTaskEventRef=OsEvent_BSW_Crypto_Main, OsTaskResourceRef=OsResource_BG
      OsTask_BSW_BG_Fota_Main: OsTaskPriority=3, OsTaskStackSize=8192, OsTaskEventRef=OsEvent_BSW_Fota_Main, OsTaskResourceRef=OsResource_BG
      OsTask_BSW_HSM_Init: OsTaskPriority=100
        OsTaskAutostart: OsTaskAppModeRef=OsAppMode0
      OsTask_BSW_FG1_100ms: OsTaskPriority=120, OsTaskResourceRef=OsResource_FG1
      OsTask_CAN_DREE_Process: OsTaskPriority=142, OsTaskStackSize=800, OsTaskResourceRef=OsResource_FG1, OsTaskEventRef=OsEvent_CAN_DREE_0, OsTaskEventRef=OsEvent_CAN_DREE_1, OsTaskEventRef=OsEvent_CAN_DREE_2, OsTaskEventRef=OsEvent_CAN_DREE_3, OsTaskEventRef=OsEvent_CAN_DREE_4
